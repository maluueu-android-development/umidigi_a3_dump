/dts-v1/;

/ {
	model = "mt6739";
	compatible = "mediatek,mt6739";
	interrupt-parent = <0x1>;
	#address-cells = <0x2>;
	#size-cells = <0x2>;

	chosen {
		bootargs = "console=tty0 console=ttyMT0,921600n1 root=/dev/ram initrd=0x44000000,0x1000000 loglevel=8 androidboot.selinux=permissive";
		linux,phandle = <0x38>;
		phandle = <0x38>;
	};

	pmu {
		compatible = "arm,armv8-pmuv3";
		interrupt-parent = <0x2>;
		interrupts = <0x1 0x7 0x8>;
	};

	cpus {
		#address-cells = <0x1>;
		#size-cells = <0x0>;

		cpu@0 {
			device_type = "cpu";
			compatible = "arm,cortex-a53";
			reg = <0x0>;
			enable-method = "psci";
			cpu-release-addr = <0x0 0x40000200>;
			clock-frequency = <0x77359400>;
			cpu-idle-states = <0x3 0x4 0x5 0x6 0x7 0x8 0x9>;
			linux,phandle = <0xa>;
			phandle = <0xa>;
		};

		cpu@001 {
			device_type = "cpu";
			compatible = "arm,cortex-a53";
			reg = <0x1>;
			enable-method = "psci";
			cpu-release-addr = <0x0 0x40000200>;
			clock-frequency = <0x61a1e580>;
			cpu-idle-states = <0x3 0x4 0x5 0x6 0x7 0x8 0x9>;
			linux,phandle = <0xb>;
			phandle = <0xb>;
		};

		cpu@002 {
			device_type = "cpu";
			compatible = "arm,cortex-a53";
			reg = <0x2>;
			enable-method = "psci";
			cpu-release-addr = <0x0 0x40000200>;
			clock-frequency = <0x61a1e580>;
			cpu-idle-states = <0x3 0x4 0x5 0x6 0x7 0x8 0x9>;
			linux,phandle = <0xc>;
			phandle = <0xc>;
		};

		cpu@003 {
			device_type = "cpu";
			compatible = "arm,cortex-a53";
			reg = <0x3>;
			enable-method = "psci";
			cpu-release-addr = <0x0 0x40000200>;
			clock-frequency = <0x61a1e580>;
			cpu-idle-states = <0x3 0x4 0x5 0x6 0x7 0x8 0x9>;
			linux,phandle = <0xd>;
			phandle = <0xd>;
		};

		cpu-map {

			cluster0 {

				core0 {
					cpu = <0xa>;
				};

				core1 {
					cpu = <0xb>;
				};

				core2 {
					cpu = <0xc>;
				};

				core3 {
					cpu = <0xd>;
				};
			};
		};

		idle-states {
			entry-method = "arm,psci";

			standby {
				compatible = "arm,idle-state";
				arm,psci-suspend-param = <0x1>;
				entry-latency-us = <0x258>;
				exit-latency-us = <0x258>;
				min-residency-us = <0x4b0>;
				linux,phandle = <0x3>;
				phandle = <0x3>;
			};

			mcdi-cpu {
				compatible = "arm,idle-state";
				arm,psci-suspend-param = <0x10001>;
				entry-latency-us = <0x258>;
				exit-latency-us = <0x258>;
				min-residency-us = <0x4b0>;
				linux,phandle = <0x4>;
				phandle = <0x4>;
			};

			mcdi-cluster {
				compatible = "arm,idle-state";
				arm,psci-suspend-param = <0x1010001>;
				entry-latency-us = <0x258>;
				exit-latency-us = <0x258>;
				min-residency-us = <0x4b0>;
				linux,phandle = <0x5>;
				phandle = <0x5>;
			};

			sodi {
				compatible = "arm,idle-state";
				arm,psci-suspend-param = <0x1010002>;
				entry-latency-us = <0x320>;
				exit-latency-us = <0x3e8>;
				min-residency-us = <0x7d0>;
				linux,phandle = <0x6>;
				phandle = <0x6>;
			};

			sodi3 {
				compatible = "arm,idle-state";
				arm,psci-suspend-param = <0x1010003>;
				entry-latency-us = <0x320>;
				exit-latency-us = <0x3e8>;
				min-residency-us = <0x7d0>;
				linux,phandle = <0x7>;
				phandle = <0x7>;
			};

			dpidle {
				compatible = "arm,idle-state";
				arm,psci-suspend-param = <0x1010004>;
				entry-latency-us = <0x320>;
				exit-latency-us = <0x3e8>;
				min-residency-us = <0x7d0>;
				linux,phandle = <0x8>;
				phandle = <0x8>;
			};

			suspend {
				compatible = "arm,idle-state";
				arm,psci-suspend-param = <0x1010005>;
				entry-latency-us = <0x320>;
				exit-latency-us = <0x3e8>;
				min-residency-us = <0x7d0>;
				linux,phandle = <0x9>;
				phandle = <0x9>;
			};
		};
	};

	mobicore {
		compatible = "trustonic,mobicore";
		interrupts = <0x0 0x6e 0x1>;
	};

	psci {
		compatible = "arm,psci-0.2";
		method = "smc";
	};

	memory {
		device_type = "memory";
		reg = <0x0 0x40000000 0x0 0x20000000>;
	};

	cpu_dbgapb {
		compatible = "mediatek,hw_dbg";
		num = <0x4>;
		reg = <0x0 0xd410000 0x0 0x1000 0x0 0xd510000 0x0 0x1000 0x0 0xd610000 0x0 0x1000 0x0 0xd710000 0x0 0x1000>;
		linux,phandle = <0x39>;
		phandle = <0x39>;
	};

	atf_logger {
		compatible = "mediatek,atf_logger";
		interrupts = <0x0 0xf1 0x1>;
	};

	amms_control {
		compatible = "mediatek,amms";
		interrupts = <0x0 0x7b 0x1>;
	};

	utos {
		compatible = "microtrust,utos";
		interrupts = <0x0 0x83 0x1 0x0 0x84 0x1>;
	};

	utos_tester {
		compatible = "microtrust,tester-v1";
	};

	reserved-memory {
		#address-cells = <0x2>;
		#size-cells = <0x2>;
		ranges;
		linux,phandle = <0x3a>;
		phandle = <0x3a>;

		pstore-reserved-memory@44410000 {
			compatible = "mediatek,pstore";
			reg = <0x0 0x44410000 0x0 0xe0000>;
		};

		ram_console-reserved-memory@44400000 {
			compatible = "mediatek,ram_console";
			reg = <0x0 0x44400000 0x0 0x10000>;
		};

		minirdump-reserved-memory@444f0000 {
			compatible = "mediatek,minirdump";
			reg = <0x0 0x444f0000 0x0 0x10000>;
		};

		consys-reserve-memory {
			compatible = "mediatek,consys-reserve-memory";
			#address-cells = <0x2>;
			#size-cells = <0x2>;
			no-map;
			size = <0x0 0x200000>;
			alignment = <0x0 0x200000>;
			alloc-ranges = <0x0 0x40000000 0x0 0x38000000>;
		};

		soter-shared-mem {
			compatible = "microtrust,shared_mem";
			no-map;
			alloc-ranges = <0x0 0x40000000 0x0 0x38000000>;
			size = <0x0 0x500000>;
		};
	};

	interrupt-controller@0c000000 {
		compatible = "arm,gic-v3";
		#interrupt-cells = <0x3>;
		#address-cells = <0x2>;
		#size-cells = <0x2>;
		#redistributor-regions = <0x1>;
		interrupt-parent = <0x2>;
		interrupt-controller;
		reg = <0x0 0xc000000 0x0 0x40000 0x0 0xc080000 0x0 0x200000 0x0 0x10200620 0x0 0x1000>;
		interrupts = <0x1 0x9 0x4>;
		mediatek,reg_len_pol0 = <0x8>;
		linux,phandle = <0x2>;
		phandle = <0x2>;
	};

	intpol-controller@0x10200620 {
		compatible = "mediatek,mt6739-sysirq", "mediatek,mt6577-sysirq";
		interrupt-controller;
		#interrupt-cells = <0x3>;
		interrupt-parent = <0x2>;
		reg = <0x0 0x10200620 0x0 0x20>;
		linux,phandle = <0x1>;
		phandle = <0x1>;
	};

	chipid@08000000 {
		compatible = "mediatek,chipid";
		reg = <0x0 0x8000000 0x0 0x4 0x0 0x8000004 0x0 0x4 0x0 0x8000008 0x0 0x4 0x0 0x800000c 0x0 0x4>;
	};

	timer {
		compatible = "arm,armv8-timer";
		interrupt-parent = <0x2>;
		interrupts = <0x1 0xd 0x8 0x1 0xe 0x8 0x1 0xb 0x8 0x1 0xa 0x8>;
		clock-frequency = <0xc65d40>;
	};

	clk26m {
		compatible = "fixed-clock";
		#clock-cells = <0x0>;
		clock-frequency = <0x18cba80>;
		linux,phandle = <0x26>;
		phandle = <0x26>;
	};

	topckgen@10000000 {
		compatible = "mediatek,topckgen", "syscon";
		reg = <0x0 0x10000000 0x0 0x1000 0x0 0x1000c000 0x0 0x1000>;
		#clock-cells = <0x1>;
		linux,phandle = <0x25>;
		phandle = <0x25>;
	};

	infracfg_ao@10001000 {
		compatible = "mediatek,infracfg_ao", "syscon";
		reg = <0x0 0x10001000 0x0 0x1000>;
		interrupts = <0x0 0x93 0x1>;
		#clock-cells = <0x1>;
		linux,phandle = <0x19>;
		phandle = <0x19>;
	};

	scpsys@10001000 {
		compatible = "mediatek,scpsys";
		reg = <0x0 0x10001000 0x0 0x1000 0x0 0x10006000 0x0 0x1000 0x0 0x1020e000 0x0 0x1000>;
		#clock-cells = <0x1>;
		linux,phandle = <0x1a>;
		phandle = <0x1a>;
	};

	clk32k {
		compatible = "fixed-clock";
		#clock-cells = <0x0>;
		clock-frequency = <0x7d00>;
		linux,phandle = <0x18>;
		phandle = <0x18>;
	};

	io_cfg_lt@10002000 {
		compatible = "mediatek,io_cfg_lt";
		reg = <0x0 0x10002000 0x0 0x200>;
	};

	syscfg_pctl_lt@10002000 {
		compatible = "mediatek,pctl-lt-syscfg", "syscon";
		reg = <0x0 0x10002000 0x0 0x1000>;
		linux,phandle = <0xf>;
		phandle = <0xf>;
	};

	io_cfg_lm@10002200 {
		compatible = "mediatek,io_cfg_lm";
		reg = <0x0 0x10002200 0x0 0x200>;
	};

	syscfg_pctl_lm@10002200 {
		compatible = "mediatek,pctl-lm-syscfg", "syscon";
		reg = <0x0 0x10002200 0x0 0x1000>;
		linux,phandle = <0x10>;
		phandle = <0x10>;
	};

	io_cfg_lb@10002400 {
		compatible = "mediatek,io_cfg_lb";
		reg = <0x0 0x10002400 0x0 0x200>;
	};

	syscfg_pctl_lb@10002400 {
		compatible = "mediatek,pctl-lb-syscfg", "syscon";
		reg = <0x0 0x10002400 0x0 0x1000>;
		linux,phandle = <0x11>;
		phandle = <0x11>;
	};

	io_cfg_bl@10002600 {
		compatible = "mediatek,io_cfg_bl";
		reg = <0x0 0x10002600 0x0 0x200>;
	};

	syscfg_pctl_bl@10002600 {
		compatible = "mediatek,pctl-bl-syscfg", "syscon";
		reg = <0x0 0x10002600 0x0 0x1000>;
		linux,phandle = <0x12>;
		phandle = <0x12>;
	};

	io_cfg_bm@10002800 {
		compatible = "mediatek,io_cfg_bm";
		reg = <0x0 0x10002800 0x0 0x200>;
	};

	syscfg_pctl_bm@10002800 {
		compatible = "mediatek,pctl-bm-syscfg", "syscon";
		reg = <0x0 0x10002800 0x0 0x1000>;
		linux,phandle = <0x13>;
		phandle = <0x13>;
	};

	io_cfg_rb@10002a00 {
		compatible = "mediatek,io_cfg_rb";
		reg = <0x0 0x10002a00 0x0 0x200>;
	};

	syscfg_pctl_rb@10002a00 {
		compatible = "mediatek,pctl-rb-syscfg", "syscon";
		reg = <0x0 0x10002a00 0x0 0x1000>;
		linux,phandle = <0x14>;
		phandle = <0x14>;
	};

	io_cfg_rt@10002c00 {
		compatible = "mediatek,io_cfg_rt";
		reg = <0x0 0x10002c00 0x0 0x200>;
	};

	syscfg_pctl_bl@10002c00 {
		compatible = "mediatek,pctl-rt-syscfg", "syscon";
		reg = <0x0 0x10002c00 0x0 0x1000>;
		linux,phandle = <0x15>;
		phandle = <0x15>;
	};

	pericfg@10003000 {
		compatible = "mediatek,pericfg";
		reg = <0x0 0x10003000 0x0 0x1000>;
	};

	efuse_dbg@10004000 {
		compatible = "mediatek,efuse_dbg";
		reg = <0x0 0x10004000 0x0 0x1000>;
	};

	gpio {
		compatible = "mediatek,gpio_usage_mapping";
		linux,phandle = <0x3b>;
		phandle = <0x3b>;
	};

	gpio@10005000 {
		compatible = "mediatek,gpio";
		reg = <0x0 0x10005000 0x0 0x1000>;
		linux,phandle = <0x3c>;
		phandle = <0x3c>;
	};

	syscfg_pctl_a@10005000 {
		compatible = "mediatek,pctl-a-syscfg", "syscon";
		reg = <0x0 0x10005000 0x0 0x1000>;
		linux,phandle = <0xe>;
		phandle = <0xe>;
	};

	accdet {
		compatible = "mediatek,pmic-accdet";
		linux,phandle = <0x3d>;
		phandle = <0x3d>;
	};

	pinctrl@1000b000 {
		compatible = "mediatek,pinctrl";
		reg = <0x0 0x1000b000 0x0 0x1000>;
		mediatek,pctl-regmap = <0xe 0xf 0x10 0x11 0x12 0x13 0x14 0x15>;
		pins-are-numbered;
		gpio-controller;
		#gpio-cells = <0x2>;
		interrupt-controller;
		#interrupt-cells = <0x4>;
		interrupts = <0x0 0xa7 0x4>;
		linux,phandle = <0x24>;
		phandle = <0x24>;
	};

	sleep@10006000 {
		compatible = "mediatek,sleep";
		reg = <0x0 0x10006000 0x0 0x1000>;
		interrupts = <0x0 0xb1 0x8>;
		wakeup-source = <0x16 0x0 0x4 0x17 0x3 0x2000000>;
	};

	toprgu@10007000 {
		compatible = "mediatek,toprgu";
		reg = <0x0 0x10007000 0x0 0x1000>;
		interrupts = <0x0 0x8b 0x0>;
	};

	apxgpt@10008000 {
		compatible = "mediatek,apxgpt";
		reg = <0x0 0x10008000 0x0 0x1000>;
		interrupts = <0x0 0xa6 0x8>;
		clocks = <0x18>;
	};

	hacc@1000a000 {
		compatible = "mediatek,hacc";
		reg = <0x0 0x1000a000 0x0 0x1000>;
		interrupts = <0x0 0xb5 0x8>;
	};

	apmixed@1000c000 {
		compatible = "mediatek,apmixed", "mediatek,apmixedsys", "syscon";
		reg = <0x0 0x1000c000 0x0 0x1000>;
		#clock-cells = <0x1>;
		linux,phandle = <0x32>;
		phandle = <0x32>;
	};

	fhctl@1000ce00 {
		compatible = "mediatek,fhctl";
		reg = <0x0 0x1000ce00 0x0 0x0>;
	};

	pwrap@1000d000 {
		compatible = "mediatek,pwrap";
		reg = <0x0 0x1000d000 0x0 0x1000>;
		interrupts = <0x0 0xaf 0x4>;

		pmic_irq {
			compatible = "mediatek,pmic-eint";
			interrupt-controller;
			linux,phandle = <0x3e>;
			phandle = <0x3e>;
		};
	};

	sleep_reg_md@1000f000 {
		compatible = "mediatek,sleep_reg_md";
		reg = <0x0 0x1000f000 0x0 0x1000>;
	};

	kp@10010000 {
		compatible = "mediatek,kp";
		reg = <0x0 0x10010000 0x0 0x1000>;
		interrupts = <0x0 0xb0 0x2>;
		linux,phandle = <0x16>;
		phandle = <0x16>;
	};

	topmisc@10011000 {
		compatible = "mediatek,topmisc";
		reg = <0x0 0x10011000 0x0 0x1000>;
	};

	dvfsrc_top@10012000 {
		compatible = "mediatek,dvfsrc_top";
		reg = <0x0 0x10012000 0x0 0x1000>;
	};

	mbist_ao@10013000 {
		compatible = "mediatek,mbist_ao";
		reg = <0x0 0x10013000 0x0 0x1000>;
	};

	apcldmain_ao@10014000 {
		compatible = "mediatek,apcldmain_ao";
		reg = <0x0 0x10014000 0x0 0x400>;
	};

	apcldmaout_ao@10014400 {
		compatible = "mediatek,apcldmaout_ao";
		reg = <0x0 0x10014400 0x0 0x400>;
	};

	apcldmamisc_ao@10014800 {
		compatible = "mediatek,apcldmamisc_ao";
		reg = <0x0 0x10014800 0x0 0x400>;
	};

	apcldmamisc_ao@10014c00 {
		compatible = "mediatek,apcldmamisc_ao";
		reg = <0x0 0x10014c00 0x0 0x400>;
	};

	aes_top0@10016000 {
		compatible = "mediatek,aes_top0";
		reg = <0x0 0x10016000 0x0 0x1000>;
	};

	sys_timer@10017000 {
		compatible = "mediatek,sys_timer";
		reg = <0x0 0x10017000 0x0 0x1000 0x0 0x10ffec 0x0 0x14>;
		interrupts = <0x0 0xba 0x4>;
		mediatek,sysram-size = <0x14>;
	};

	modem_temp_share@10018000 {
		compatible = "mediatek,modem_temp_share";
		reg = <0x0 0x10018000 0x0 0x1000>;
	};

	security_ao@1001a000 {
		compatible = "mediatek,security_ao";
		reg = <0x0 0x1001a000 0x0 0x1000>;
	};

	topckgen_ao@1001b000 {
		compatible = "mediatek,topckgen_ao";
		reg = <0x0 0x1001b000 0x0 0x1000>;
	};

	dramc0@1001d000 {
		compatible = "mediatek,dramc0";
		reg = <0x0 0x1001d000 0x0 0x1000>;
	};

	dramc@1001d000 {
		compatible = "mediatek,dramc";
		reg = <0x0 0x1001d000 0x0 0x1000 0x0 0x1021d000 0x0 0x1000 0x0 0x1001e000 0x0 0x1000>;
	};

	ddrphy@1001e000 {
		compatible = "mediatek,ddrphy";
		reg = <0x0 0x1001e000 0x0 0x1000>;
	};

	iocfg_0@10002000 {
		compatible = "mediatek,iocfg_0";
		reg = <0x0 0x10002000 0x0 0x200>;
	};

	iocfg_1@10002200 {
		compatible = "mediatek,iocfg_1";
		reg = <0x0 0x10002200 0x0 0x200>;
	};

	iocfg_2@10002400 {
		compatible = "mediatek,iocfg_2";
		reg = <0x0 0x10002400 0x0 0x200>;
	};

	iocfg_3@10002600 {
		compatible = "mediatek,iocfg_3";
		reg = <0x0 0x10002600 0x0 0x200>;
	};

	iocfg_4@10002800 {
		compatible = "mediatek,iocfg_4";
		reg = <0x0 0x10002800 0x0 0x200>;
	};

	iocfg_5@10002a00 {
		compatible = "mediatek,iocfg_5";
		reg = <0x0 0x10002a00 0x0 0x200>;
	};

	mdcldmain_ao@10015000 {
		compatible = "mediatek,mdcldmain_ao";
		reg = <0x0 0x10015000 0x0 0x400>;
	};

	mdcldmaout_ao@10015400 {
		compatible = "mediatek,mdcldmaout_ao";
		reg = <0x0 0x10015400 0x0 0x400>;
	};

	mdcldmamisc_ao@10015800 {
		compatible = "mediatek,mdcldmamisc_ao";
		reg = <0x0 0x10015800 0x0 0x400>;
	};

	sys_cirq@10204000 {
		compatible = "mediatek,sys_cirq";
		reg = <0x0 0x10204000 0x0 0x1000>;
		mediatek,cirq_num = <0xa8>;
		mediatek,spi_start_offset = <0x48>;
		interrupts = <0x0 0xf0 0x8>;
	};

	mcucfg@10200000 {
		compatible = "mediatek,mcucfg";
		reg = <0x0 0x10200000 0x0 0x1000>;
		interrupts = <0x0 0x0 0x8>;
	};

	m4u@10205000 {
		cell-index = <0x0>;
		compatible = "mediatek,m4u";
		reg = <0x0 0x10205000 0x0 0x1000>;
		interrupts = <0x0 0x9e 0x8>;
	};

	devapc@10207000 {
		compatible = "mediatek,devapc";
		reg = <0x0 0x10207000 0x0 0x1000>;
		interrupts = <0x0 0x8e 0x8>;
		clocks = <0x19 0x2a>;
		clock-names = "devapc-infra-clock";
	};

	bus_dbg@10208000 {
		compatible = "mediatek,bus_dbg-v2";
		reg = <0x0 0x10208000 0x0 0x1000 0x0 0x10001000 0x0 0x1000>;
		mediatek,bus_dbg_con_offset = <0x2fc>;
		interrupts = <0x0 0x8d 0x8>;
	};

	ap_ccif0@10209000 {
		compatible = "mediatek,ap_ccif0";
		reg = <0x0 0x10209000 0x0 0x1000>;
		interrupts = <0x0 0x94 0x8>;
	};

	md_ccif0@1020a000 {
		compatible = "mediatek,md_ccif0";
		reg = <0x0 0x1020a000 0x0 0x1000>;
	};

	ap_ccif1@1020b000 {
		compatible = "mediatek,ap_ccif1";
		reg = <0x0 0x1020b000 0x0 0x1000>;
		interrupts = <0x0 0x96 0x8>;
	};

	md_ccif1@1020c000 {
		compatible = "mediatek,md_ccif1";
		reg = <0x0 0x1020c000 0x0 0x1000>;
	};

	infra_mbist@1020d000 {
		compatible = "mediatek,infra_mbist";
		reg = <0x0 0x1020d000 0x0 0x1000>;
	};

	infracfg@1020e000 {
		compatible = "mediatek,infracfg";
		reg = <0x0 0x1020e000 0x0 0x1000>;
	};

	trng@1020f000 {
		compatible = "mediatek,trng";
		reg = <0x0 0x1020f000 0x0 0x1000>;
		interrupts = <0x0 0xa1 0x8>;
	};

	dxcc_sec@10210000 {
		compatible = "mediatek,dxcc_sec";
		reg = <0x0 0x10210000 0x0 0x1000>;
		interrupts = <0x0 0xa2 0x4>;
	};

	md2md_md1_ccif0@10211000 {
		compatible = "mediatek,md2md_md1_ccif0";
		reg = <0x0 0x10211000 0x0 0x1000>;
	};

	cq_dma@10212000 {
		compatible = "mediatek,mt-cqdma-v1";
		reg = <0x0 0x10212080 0x0 0x80>;
		interrupts = <0x0 0x72 0x8>;
		nr_channel = <0x1>;
		keep_clock_ao = "yes";
		clocks = <0x19 0x44>;
		clock-names = "cqdma";
	};

	md2md_md2_ccif0@10213000 {
		compatible = "mediatek,md2md_md2_ccif0";
		reg = <0x0 0x10213000 0x0 0x1000>;
	};

	sramrom@10214000 {
		compatible = "mediatek,sramrom";
		reg = <0x0 0x10214000 0x0 0x1000>;
	};

	mipi_tx0@11c80000 {
		compatible = "mediatek,mipi_tx0";
		reg = <0x0 0x11c80000 0x0 0x1000>;
	};

	mcdi@10216000 {
		compatible = "mediatek,mt6739-mcdi";
		reg = <0x0 0x10fc00 0x0 0x400 0x0 0x10216000 0x0 0x1000 0x0 0x10217000 0x0 0x2000>;
	};

	emi@10219000 {
		compatible = "mediatek,emi";
		reg = <0x0 0x10219000 0x0 0x1000 0x0 0x1021a000 0x0 0x1000 0x0 0x10226000 0x0 0x1000>;
		interrupts = <0x0 0x90 0x8>;
	};

	apcldmain@1021b000 {
		compatible = "mediatek,apcldmain";
		reg = <0x0 0x1021b000 0x0 0x0>;
	};

	apcldmain@1021b100 {
		compatible = "mediatek,apcldmain";
		reg = <0x0 0x1021b100 0x0 0x0>;
	};

	apcldmaout@1021b400 {
		compatible = "mediatek,apcldmaout";
		reg = <0x0 0x1021b400 0x0 0x0>;
	};

	apcldmaout@1021b500 {
		compatible = "mediatek,apcldmaout";
		reg = <0x0 0x1021b500 0x0 0x0>;
	};

	apcldmamisc@1021b800 {
		compatible = "mediatek,apcldmamisc";
		reg = <0x0 0x1021b800 0x0 0x0>;
		interrupts = <0x0 0xa5 0x4>;
	};

	apcldmamisc@1021b900 {
		compatible = "mediatek,apcldmamisc";
		reg = <0x0 0x1021b900 0x0 0x400>;
	};

	mdcldmain@1021c000 {
		compatible = "mediatek,mdcldmain";
		reg = <0x0 0x1021c000 0x0 0x400>;
	};

	mdcldmaout@1021c400 {
		compatible = "mediatek,mdcldmaout";
		reg = <0x0 0x1021c400 0x0 0x400>;
	};

	mdcldmamisc@1021c000 {
		compatible = "mediatek,mdcldmamisc";
		reg = <0x0 0x1021c000 0x0 0x0>;
	};

	mdcldmamisc@1021c900 {
		compatible = "mediatek,mdcldmamisc";
		reg = <0x0 0x1021c900 0x0 0x400>;
	};

	mdcldma@10014000 {
		compatible = "mediatek,mdcldma";
		reg = <0x0 0x10014000 0x0 0x1000 0x0 0x1021b000 0x0 0x1000 0x0 0x10209000 0x0 0x1000 0x0 0x1020a000 0x0 0x1000>;
		interrupts = <0x0 0xa5 0x4 0x0 0x94 0x8 0x0 0x95 0x8 0x0 0xe3 0x2>;
		mediatek,md_id = <0x0>;
		mediatek,cldma_capability = <0x6>;
		clocks = <0x1a 0x2 0x19 0x34 0x19 0x2b 0x19 0x2e 0x19 0x24 0x19 0x25>;
		clock-names = "scp-sys-md1-main", "infra-cldma-bclk", "infra-ccif-ap", "infra-ccif-md", "infra-ccif1-ap", "infra-ccif1-md";
		linux,phandle = <0x17>;
		phandle = <0x17>;
	};

	dramc_nao@1021d000 {
		compatible = "mediatek,dramc_nao";
		reg = <0x0 0x1021d000 0x0 0x1000>;
	};

	bpi_bsi_slv0@1021e000 {
		compatible = "mediatek,bpi_bsi_slv0";
		reg = <0x0 0x1021e000 0x0 0x1000>;
	};

	bpi_bsi_slv1@1021f000 {
		compatible = "mediatek,bpi_bsi_slv1";
		reg = <0x0 0x1021f000 0x0 0x6000>;
	};

	bpi_bsi_slv2@10225000 {
		compatible = "mediatek,bpi_bsi_slv2";
		reg = <0x0 0x10225000 0x0 0x1000>;
	};

	dvfsp@10227000 {
		compatible = "mediatek,dvfsp";
		reg = <0x0 0x10227000 0x0 0x1000>;
		interrupts = <0x0 0xa3 0x8>;
	};

	gce@10228000 {
		compatible = "mediatek,gce";
		reg = <0x0 0x10228000 0x0 0x4000>;
		interrupts = <0x0 0x9a 0x8 0x0 0x9b 0x8>;
		g3d_config_base = <0x13000000 0x0 0xffff0000>;
		mmsys_config_base = <0x14000000 0x1 0xffff0000>;
		disp_dither_base = <0x14010000 0x2 0xffff0000>;
		mm_na_base = <0x14020000 0x3 0xffff0000>;
		imgsys_base = <0x15020000 0x4 0xffff0000>;
		vdec_gcon_base = <0x18800000 0x5 0xffff0000>;
		venc_gcon_base = <0x18810000 0x6 0xffff0000>;
		conn_peri_base = <0x18820000 0x7 0xffff0000>;
		topckgen_base = <0x18830000 0x8 0xffff0000>;
		kp_base = <0x18840000 0x9 0xffff0000>;
		scp_sram_base = <0x10000000 0xa 0xffff0000>;
		infra_na3_base = <0x10010000 0xb 0xffff0000>;
		infra_na4_base = <0x10020000 0xc 0xffff0000>;
		scp_base = <0x10030000 0xd 0xffff0000>;
		mcucfg_base = <0x10040000 0xe 0xffff0000>;
		gcpu_base = <0x10050000 0xf 0xffff0000>;
		usb0_base = <0x10200000 0x10 0xffff0000>;
		usb_sif_base = <0x10280000 0x11 0xffff0000>;
		audio_base = <0x17000000 0x12 0xffff0000>;
		vdec_base = <0x17010000 0x13 0xffff0000>;
		msdc2_base = <0x17020000 0x14 0xffff0000>;
		vdec1_base = <0x17030000 0x15 0xffff0000>;
		msdc3_base = <0x18000000 0x16 0xffff0000>;
		ap_dma_base = <0x18010000 0x17 0xffff0000>;
		gce_base = <0x18020000 0x18 0xffff0000>;
		vdec2_base = <0x18040000 0x19 0xffff0000>;
		vdec3_base = <0x18050000 0x1a 0xffff0000>;
		camsys_base = <0x18080000 0x1b 0xffff0000>;
		camsys1_base = <0x180a0000 0x1c 0xffff0000>;
		camsys2_base = <0x180b0000 0x1d 0xffff0000>;
		pwm_sw_base = <0x11000000 0x63 0xffff0000>;
		mdp_rdma0_sof = <0x0>;
		mdp_rsz0_sof = <0x1>;
		mdp_rsz1_sof = <0x2>;
		mdp_wdma_sof = <0x3>;
		mdp_wrot0_sof = <0x4>;
		mdp_tdshp_sof = <0x5>;
		disp_ovl0_sof = <0x6>;
		disp_rdma0_sof = <0x7>;
		disp_wdma0_sof = <0x8>;
		disp_color0_sof = <0x9>;
		disp_ccorr0_sof = <0xa>;
		disp_aal0_sof = <0xb>;
		disp_gamma0_sof = <0xc>;
		disp_dither0_sof = <0xd>;
		disp_dsi0_sof = <0xe>;
		disp_dbi0_sof = <0xf>;
		disp_pwm0_sof = <0x10>;
		disp_rdma0_frame_done = <0x11>;
		mdp_rdma0_frame_done = <0x12>;
		mdp_rsz0_frame_done = <0x13>;
		mdp_rsz1_frame_done = <0x14>;
		mdp_tdshp_frame_done = <0x15>;
		mdp_wrot0_write_frame_done = <0x16>;
		mdp_wdma_frame_done = <0x17>;
		disp_ovl0_frame_done = <0x18>;
		disp_wdma0_frame_done = <0x19>;
		disp_color0_frame_done = <0x1a>;
		disp_ccorr0_frame_done = <0x1b>;
		disp_aal0_frame_done = <0x1c>;
		disp_gamma0_frame_done = <0x1d>;
		disp_dither0_frame_done = <0x1e>;
		disp_dsi0_frame_done = <0x1f>;
		disp_dbi0_frame_done = <0x20>;
		stream_done_0 = <0x82>;
		stream_done_1 = <0x83>;
		stream_done_2 = <0x84>;
		stream_done_3 = <0x85>;
		stream_done_4 = <0x86>;
		stream_done_5 = <0x87>;
		stream_done_6 = <0x88>;
		stream_done_7 = <0x89>;
		stream_done_8 = <0x8a>;
		stream_done_9 = <0x8b>;
		buf_underrun_event_0 = <0x8c>;
		buf_underrun_event_1 = <0x8d>;
		dsi0_te_event = <0x8e>;
		dsi0_irq_event = <0x8f>;
		dsi0_done_event = <0x90>;
		disp_wdma0_rst_done = <0x94>;
		mdp_wdma_rst_done = <0x95>;
		mdp_wrot0_rst_done = <0x96>;
		mdp_rdma0_rst_done = <0x98>;
		disp_ovl0_frame_rst_done_pusle = <0x99>;
		isp_frame_done_p2_2 = <0x101>;
		isp_frame_done_p2_1 = <0x102>;
		isp_frame_done_p2_0 = <0x103>;
		isp_frame_done_p1_1 = <0x104>;
		isp_frame_done_p1_0 = <0x105>;
		camsv_2_pass1_done = <0x106>;
		camsv_1_pass1_done = <0x107>;
		seninf_cam1_2_3_fifo_full = <0x108>;
		seninf_cam0_fifo_full = <0x109>;
		venc_done = <0x121>;
		jpgenc_done = <0x122>;
		jpgdec_done = <0x123>;
		venc_mb_done = <0x124>;
		venc_128byte_cnt_done = <0x125>;
		max_prefetch_cnt = <0x1>;
		prefetch_size = <0x60>;
		sram_size_cpr_64 = <0x40>;
		mmsys_config = <0x1b>;
		mdp_rdma0 = <0x1c>;
		mdp_rsz0 = <0x1d>;
		mdp_rsz1 = <0x1e>;
		mdp_wdma0 = <0x1f>;
		mdp_wrot0 = <0x20>;
		mdp_tdshp0 = <0x21>;
		disp_ovl0 = <0x22>;
		mm_mutex = <0x23>;
		sram_share_cnt = <0x1>;
		sram_share_engine = <0x8>;
		sram_share_event = <0x1e0>;
		clocks = <0x19 0x7 0x19 0x18>;
		clock-names = "GCE", "GCE_TIMER";
	};

	dramc_ch0_top0@10228000 {
		compatible = "mediatek,dramc_ch0_top0";
		reg = <0x0 0x10228000 0x0 0x2000>;
	};

	dramc_ch0_top1@1022a000 {
		compatible = "mediatek,dramc_ch0_top1";
		reg = <0x0 0x1022a000 0x0 0x2000>;
	};

	dramc_ch0_top2@1022c000 {
		compatible = "mediatek,dramc_ch0_top2";
		reg = <0x0 0x1022c000 0x0 0x1000>;
	};

	dramc_ch0_top3@1022d000 {
		compatible = "mediatek,dramc_ch0_top3";
		reg = <0x0 0x1022d000 0x0 0x1000>;
	};

	dramc_ch0_rsv@1022e000 {
		compatible = "mediatek,dramc_ch0_rsv";
		reg = <0x0 0x1022e000 0x0 0x2000>;
	};

	dramc_ch1_top0@10230000 {
		compatible = "mediatek,dramc_ch1_top0";
		reg = <0x0 0x10230000 0x0 0x2000>;
	};

	dramc_ch1_top1@10232000 {
		compatible = "mediatek,dramc_ch1_top1";
		reg = <0x0 0x10232000 0x0 0x2000>;
	};

	dramc_ch1_top2@10234000 {
		compatible = "mediatek,dramc_ch1_top2";
		reg = <0x0 0x10234000 0x0 0x1000>;
	};

	dramc_ch1_top3@10235000 {
		compatible = "mediatek,dramc_ch1_top3";
		reg = <0x0 0x10235000 0x0 0x1000>;
	};

	dramc_ch1_rsv@10236000 {
		compatible = "mediatek,dramc_ch1_rsv";
		reg = <0x0 0x10236000 0x0 0x2000>;
	};

	gic500@0c000000 {
		compatible = "mediatek,gic500";
		reg = <0x0 0xc000000 0x0 0x0>;
	};

	gic_cpu@0c400000 {
		compatible = "mediatek,gic_cpu";
		reg = <0x0 0xc400000 0x0 0x40000>;
	};

	dfd@0c600000 {
		compatible = "mediatek,dfd";
		reg = <0x0 0xc600000 0x0 0x0>;
	};

	dbg_etb@0d010000 {
		compatible = "mediatek,dbg_etb";
		reg = <0x0 0xd010000 0x0 0x10000>;
	};

	dbg_cti@0d020000 {
		compatible = "mediatek,dbg_cti";
		reg = <0x0 0xd020000 0x0 0x10000>;
	};

	dbg_etr@0d030000 {
		compatible = "mediatek,dbg_etr";
		reg = <0x0 0xd030000 0x0 0x10000>;
	};

	dbg_funnel@0d040000 {
		compatible = "mediatek,dbg_funnel";
		reg = <0x0 0xd040000 0x0 0x10000>;
	};

	dbg_dem@0d0a0000 {
		compatible = "mediatek,dbg_dem";
		reg = <0x0 0xd0a0000 0x0 0x10000>;
		interrupts = <0x0 0x8c 0x8>;
	};

	dbg_mdsys1@0d0c0000 {
		compatible = "mediatek,dbg_mdsys1";
		reg = <0x0 0xd0c0000 0x0 0x40000>;
	};

	dbg_apmcu_mp0@0d400000 {
		compatible = "mediatek,dbg_apmcu_mp0";
		reg = <0x0 0xd400000 0x0 0x1000>;
	};

	dbg_apmcu_mp0@0d410000 {
		compatible = "mediatek,dbg_apmcu_mp0";
		reg = <0x0 0xd410000 0x0 0x1000>;
	};

	dbg_apmcu_mp0@0d420000 {
		compatible = "mediatek,dbg_apmcu_mp0";
		reg = <0x0 0xd420000 0x0 0x1000>;
	};

	dbg_apmcu_mp0@0d430000 {
		compatible = "mediatek,dbg_apmcu_mp0";
		reg = <0x0 0xd430000 0x0 0x1000>;
	};

	dbg_apmcu_mp0@0d440000 {
		compatible = "mediatek,dbg_apmcu_mp0";
		reg = <0x0 0xd440000 0x0 0x1000>;
	};

	dbg_apmcu_mp0@0d510000 {
		compatible = "mediatek,dbg_apmcu_mp0";
		reg = <0x0 0xd510000 0x0 0x1000>;
	};

	dbg_apmcu_mp0@0d520000 {
		compatible = "mediatek,dbg_apmcu_mp0";
		reg = <0x0 0xd520000 0x0 0x1000>;
	};

	dbg_apmcu_mp0@0d530000 {
		compatible = "mediatek,dbg_apmcu_mp0";
		reg = <0x0 0xd530000 0x0 0x1000>;
	};

	dbg_apmcu_mp0@0d540000 {
		compatible = "mediatek,dbg_apmcu_mp0";
		reg = <0x0 0xd540000 0x0 0x1000>;
	};

	dbg_apmcu_mp0@0d610000 {
		compatible = "mediatek,dbg_apmcu_mp0";
		reg = <0x0 0xd610000 0x0 0x1000>;
	};

	dbg_apmcu_mp0@0d620000 {
		compatible = "mediatek,dbg_apmcu_mp0";
		reg = <0x0 0xd620000 0x0 0x1000>;
	};

	dbg_apmcu_mp0@0d630000 {
		compatible = "mediatek,dbg_apmcu_mp0";
		reg = <0x0 0xd630000 0x0 0x1000>;
	};

	dbg_apmcu_mp0@0d640000 {
		compatible = "mediatek,dbg_apmcu_mp0";
		reg = <0x0 0xd640000 0x0 0x1000>;
	};

	dbg_apmcu_mp0@0d710000 {
		compatible = "mediatek,dbg_apmcu_mp0";
		reg = <0x0 0xd710000 0x0 0x1000>;
	};

	dbg_apmcu_mp0@0d720000 {
		compatible = "mediatek,dbg_apmcu_mp0";
		reg = <0x0 0xd720000 0x0 0x1000>;
	};

	dbg_apmcu_mp0@0d730000 {
		compatible = "mediatek,dbg_apmcu_mp0";
		reg = <0x0 0xd730000 0x0 0x1000>;
	};

	dbg_apmcu_mp0@0d740000 {
		compatible = "mediatek,dbg_apmcu_mp0";
		reg = <0x0 0xd740000 0x0 0x1000>;
	};

	dbg_apmcu_mp1@0d800000 {
		compatible = "mediatek,dbg_apmcu_mp1";
		reg = <0x0 0xd800000 0x0 0x0>;
	};

	ap_dma@11000000 {
		compatible = "mediatek,ap_dma";
		reg = <0x0 0x11000000 0x0 0x1000>;
		interrupts = <0x0 0x52 0x8>;
	};

	auxadc@11001000 {
		compatible = "mediatek,auxadc";
		reg = <0x0 0x11001000 0x0 0x1000>;
		interrupts = <0x0 0x4a 0x2>;
		clocks = <0x19 0x22>;
		clock-names = "auxadc-main";
		linux,phandle = <0x3f>;
		phandle = <0x3f>;
	};

	apuart0@11002000 {
		cell-index = <0x0>;
		compatible = "mediatek,mtk-uart";
		reg = <0x0 0x11002000 0x0 0x1000 0x0 0x11000400 0x0 0x80 0x0 0x11000480 0x0 0x80>;
		interrupts = <0x0 0x5b 0x8 0x0 0x68 0x8 0x0 0x69 0x8>;
		clock-frequency = <0x18cba80>;
		clock-div = <0x1>;
		clocks = <0x19 0x14 0x19 0x28>;
		clock-names = "uart0-main", "uart-apdma";
		linux,phandle = <0x40>;
		phandle = <0x40>;
	};

	apuart1@11003000 {
		cell-index = <0x1>;
		compatible = "mediatek,mtk-uart";
		reg = <0x0 0x11003000 0x0 0x1000 0x0 0x11000500 0x0 0x80 0x0 0x11000580 0x0 0x80>;
		interrupts = <0x0 0x5c 0x8 0x0 0x6a 0x8 0x0 0x6b 0x8>;
		clock-frequency = <0x18cba80>;
		clock-div = <0x1>;
		clocks = <0x19 0x15>;
		clock-names = "uart1-main";
		linux,phandle = <0x41>;
		phandle = <0x41>;
	};

	pwm@11006000 {
		compatible = "mediatek,pwm";
		reg = <0x0 0x11006000 0x0 0x1000>;
		interrupts = <0x0 0x4d 0x8>;
		clocks = <0x19 0xe 0x19 0xf 0x19 0x10 0x19 0x11 0x19 0x12 0x19 0x32 0x19 0xd 0x19 0x13>;
		clock-names = "PWM1-main", "PWM2-main", "PWM3-main", "PWM4-main", "PWM5-main", "PWM6-main", "PWM-HCLK-main", "PWM-main";
	};

	i2c@11007000 {
		compatible = "mediatek,mt6739-i2c";
		id = <0x0>;
		reg = <0x0 0x11007000 0x0 0x1000 0x0 0x11000100 0x0 0x80>;
		interrupts = <0x0 0x54 0x8>;
		clocks = <0x19 0x9 0x19 0x28>;
		clock-names = "main", "dma";
		clock-div = <0x5>;
		aed = <0x1f>;
		linux,phandle = <0x42>;
		phandle = <0x42>;
	};

	i2c@11008000 {
		compatible = "mediatek,mt6739-i2c";
		id = <0x1>;
		reg = <0x0 0x11008000 0x0 0x1000 0x0 0x11000180 0x0 0x80>;
		interrupts = <0x0 0x55 0x8>;
		clocks = <0x19 0xa 0x19 0x28>;
		clock-names = "main", "dma";
		clock-div = <0x5>;
		aed = <0x1f>;
		linux,phandle = <0x43>;
		phandle = <0x43>;

		fan54005@6A {
			status = "okay";
			compatible = "onsemi,fan54005";
			reg = <0x6a>;
			en_gpio_num = <0x19>;
			en_gpio = <0x24 0x19 0x0>;
			charger_name = "primary_chg";
			ichg = <0x1f6ee0>;
			aicr = <0x7a120>;
			mivr = <0x44aa20>;
			ieoc = <0x30d40>;
			cv = <0x432380>;
			vmreg = <0x432380>;
			enable_te;
			enable_eoc_shdn;
		};
	};

	i2c@11009000 {
		compatible = "mediatek,mt6739-i2c";
		id = <0x2>;
		reg = <0x0 0x11009000 0x0 0x1000 0x0 0x11000200 0x0 0x80>;
		interrupts = <0x0 0x56 0x8>;
		clocks = <0x19 0xb 0x19 0x28>;
		clock-names = "main", "dma";
		clock-div = <0x5>;
		aed = <0x1f>;
		linux,phandle = <0x44>;
		phandle = <0x44>;
	};

	i2c@1100f000 {
		compatible = "mediatek,mt6739-i2c";
		id = <0x3>;
		reg = <0x0 0x1100f000 0x0 0x1000 0x0 0x11000280 0x0 0x80>;
		interrupts = <0x0 0x57 0x8>;
		clocks = <0x19 0xc 0x19 0x28>;
		clock-names = "main", "dma";
		clock-div = <0x5>;
		aed = <0x1f>;
		linux,phandle = <0x45>;
		phandle = <0x45>;
	};

	i2c@11011000 {
		compatible = "mediatek,mt6739-i2c";
		id = <0x4>;
		reg = <0x0 0x11011000 0x0 0x1000 0x0 0x11000300 0x0 0x80>;
		interrupts = <0x0 0x58 0x8>;
		clocks = <0x19 0x37 0x19 0x28>;
		clock-names = "main", "dma";
		clock-div = <0x5>;
		aed = <0x1f>;
		linux,phandle = <0x46>;
		phandle = <0x46>;
	};

	i2c@11016000 {
		compatible = "mediatek,mt6739-i2c";
		id = <0x5>;
		reg = <0x0 0x11016000 0x0 0x1000 0x0 0x11000380 0x0 0x80>;
		interrupts = <0x0 0x82 0x8>;
		clocks = <0x19 0x3b 0x19 0x28>;
		clock-names = "main", "dma";
		clock-div = <0x5>;
		aed = <0x1f>;
		linux,phandle = <0x47>;
		phandle = <0x47>;
	};

	spi@1100a000 {
		compatible = "mediatek,mt6739-spi";
		mediatek,pad-select = <0x0>;
		reg = <0x0 0x1100a000 0x0 0x1000>;
		interrupts = <0x0 0x76 0x8>;
		clocks = <0x25 0xa 0x25 0x30 0x19 0x1b>;
		clock-names = "parent-clk", "sel-clk", "spi-clk";
		linux,phandle = <0x48>;
		phandle = <0x48>;
	};

	spi@11010000 {
		compatible = "mediatek,mt6739-spi";
		mediatek,pad-select = <0x0>;
		reg = <0x0 0x11010000 0x0 0x1000>;
		interrupts = <0x0 0x7a 0x8>;
		clocks = <0x25 0xa 0x25 0x30 0x19 0x36>;
		clock-names = "parent-clk", "sel-clk", "spi-clk";
		linux,phandle = <0x49>;
		phandle = <0x49>;
	};

	spi@11012000 {
		compatible = "mediatek,mt6739-spi";
		mediatek,pad-select = <0x0>;
		reg = <0x0 0x11012000 0x0 0x1000>;
		interrupts = <0x0 0x80 0x8>;
		clocks = <0x25 0xa 0x25 0x30 0x19 0x39>;
		clock-names = "parent-clk", "sel-clk", "spi-clk";
		linux,phandle = <0x4a>;
		phandle = <0x4a>;
	};

	therm_ctrl@1100b000 {
		compatible = "mediatek,therm_ctrl";
		reg = <0x0 0x1100b000 0x0 0x1000>;
		interrupts = <0x0 0x4e 0x8>;
		clocks = <0x19 0x8>;
		clock-names = "therm-main";
	};

	eem_fsm@1100b000 {
		compatible = "mediatek,eem_fsm";
		reg = <0x0 0x1100b000 0x0 0x1000>;
		interrupts = <0x0 0x7d 0x8>;
		clocks = <0x25 0x2d 0x25 0x0 0x25 0x20 0x1a 0x0 0x1a 0x1>;
		clock-names = "CLK_TOP_MFG", "CLK_TOP_MFG_OFF", "CLK_TOP_MFG_ON", "CG_SCP_SYS_MFG0", "CG_SCP_SYS_MFG1";
	};

	btif@1100c000 {
		compatible = "mediatek,btif";
		#address-cells = <0x2>;
		#size-cells = <0x2>;
		reg = <0x0 0x1100c000 0x0 0x1000 0x0 0x11000600 0x0 0x80 0x0 0x11000680 0x0 0x80>;
		interrupts = <0x0 0x70 0x8 0x0 0x6c 0x8 0x0 0x6d 0x8>;
		clocks = <0x19 0x1a 0x19 0x28>;
		clock-names = "btifc", "apdmac";
	};

	irtx@1100d000 {
		compatible = "mediatek,irtx";
		reg = <0x0 0x1100d000 0x0 0x1000>;
		interrupts = <0x0 0x7f 0x8>;
	};

	disp_pwm0@1100e000 {
		compatible = "mediatek,disp_pwm0";
		reg = <0x0 0x1100e000 0x0 0x1000>;
	};

	spi2@11010000 {
		compatible = "mediatek,spi2";
		reg = <0x0 0x11010000 0x0 0x1000>;
		interrupts = <0x0 0x80 0x8>;
	};

	spi3@11012000 {
		compatible = "mediatek,spi3";
		reg = <0x0 0x11012000 0x0 0x0>;
		interrupts = <0x0 0x81 0x8>;
	};

	spi4@11013000 {
		compatible = "mediatek,spi4";
		reg = <0x0 0x11013000 0x0 0x1000>;
	};

	nfi@11018000 {
		compatible = "mediatek,nfi";
		reg = <0x0 0x11018000 0x0 0x1000>;
		interrupts = <0x0 0x86 0x8>;
		clocks = <0x25 0x3a 0x25 0x3b 0x26 0x25 0x7 0x25 0xc 0x25 0x6 0x25 0x8 0x25 0x23 0x25 0x15 0x25 0x1c 0x25 0xd 0x25 0x19 0x25 0x2 0x25 0x18 0x25 0x9 0x19 0x1e 0x19 0x27 0x19 0x4f>;
		clock-names = "nfi2x_sel", "nfiecc_sel", "clk26m", "syspll2_d2", "syspll_d7", "syspll_d3", "syspll2_d4", "msdcpll_d2", "univpll1_d2", "univpll_d5", "syspll4_d2", "univpll2_d4", "syspll1_d2", "univpll2_d2", "syspll_d5", "infra_nfiecc", "infra_nfi", "infra_nfi_1x";
	};

	nfiecc@11019000 {
		compatible = "mediatek,nfiecc";
		reg = <0x0 0x11019000 0x0 0x1000>;
		interrupts = <0x0 0x87 0x8>;
	};

	msdc@11230000 {
		compatible = "mediatek,msdc";
		reg = <0x0 0x11230000 0x0 0x10000 0x0 0x11cd0000 0x0 0x10000>;
		interrupts = <0x0 0x4f 0x8>;
		index = [00];
		clk_src = [01];
		bus-width = <0x8>;
		max-frequency = <0xbebc200>;
		cap-mmc-highspeed;
		msdc-sys-suspend;
		mmc-ddr-1_8v;
		mmc-hs200-1_8v;
		mmc-hs400-1_8v;
		non-removable;
		pinctl = <0x27>;
		register_setting = <0x28>;
		host_function = [00];
		status = "okay";
		vmmc-supply = <0x29>;
		clocks = <0x19 0x4b 0x19 0x1c>;
		clock-names = "msdc0-clock", "msdc0-hclock";
		hw_dvfs = [00];
		linux,phandle = <0x4b>;
		phandle = <0x4b>;

		msdc0@default {
			linux,phandle = <0x27>;
			phandle = <0x27>;

			pins_cmd {
				drive-strength = [04];
			};

			pins_dat {
				drive-strength = [04];
			};

			pins_clk {
				drive-strength = [04];
			};

			pins_rst {
				drive-strength = [04];
			};

			pins_ds {
				drive-strength = [04];
			};
		};

		msdc0@register_default {
			cmd_edge = [00];
			rdata_edge = [00];
			wdata_edge = [00];
			linux,phandle = <0x28>;
			phandle = <0x28>;
		};
	};

	msdc@11240000 {
		compatible = "mediatek,msdc";
		reg = <0x0 0x11240000 0x0 0x10000 0x0 0x11c40000 0x0 0x10000>;
		interrupts = <0x0 0x50 0x8>;
		index = [01];
		clk_src = [02];
		bus-width = <0x4>;
		max-frequency = <0xbebc200>;
		msdc-sys-suspend;
		cap-sd-highspeed;
		sd-uhs-sdr12;
		sd-uhs-sdr25;
		sd-uhs-sdr50;
		sd-uhs-sdr104;
		sd-uhs-ddr50;
		pinctl = <0x2a>;
		pinctl_sdr104 = <0x2b>;
		pinctl_sdr50 = <0x2c>;
		pinctl_ddr50 = <0x2d>;
		register_setting = <0x2e>;
		host_function = [01];
		cd_level = [01];
		cd-gpios = <0x24 0xf 0x0>;
		status = "okay";
		vmmc-supply = <0x2f>;
		vqmmc-supply = <0x30>;
		clocks = <0x19 0x4c 0x19 0x1d>;
		clock-names = "msdc1-clock", "msdc1-hclock";
		hw_dvfs = [00];
		linux,phandle = <0x4c>;
		phandle = <0x4c>;

		msdc1@default {
			linux,phandle = <0x2a>;
			phandle = <0x2a>;

			pins_cmd {
				drive-strength = [03];
			};

			pins_dat {
				drive-strength = [03];
			};

			pins_clk {
				drive-strength = [03];
			};
		};

		msdc1@sdr104 {
			linux,phandle = <0x2b>;
			phandle = <0x2b>;

			pins_cmd {
				drive-strength = [03];
			};

			pins_dat {
				drive-strength = [03];
			};

			pins_clk {
				drive-strength = [03];
			};
		};

		msdc1@sdr50 {
			linux,phandle = <0x2c>;
			phandle = <0x2c>;

			pins_cmd {
				drive-strength = [03];
			};

			pins_dat {
				drive-strength = [03];
			};

			pins_clk {
				drive-strength = [03];
			};
		};

		msdc1@ddr50 {
			linux,phandle = <0x2d>;
			phandle = <0x2d>;

			pins_cmd {
				drive-strength = [03];
			};

			pins_dat {
				drive-strength = [03];
			};

			pins_clk {
				drive-strength = [03];
			};
		};

		msdc1@register_default {
			cmd_edge = [00];
			rdata_edge = [00];
			wdata_edge = [00];
			linux,phandle = <0x2e>;
			phandle = <0x2e>;
		};
	};

	usb0@11200000 {
		compatible = "mediatek,mt6739-usb20";
		reg = <0x0 0x11200000 0x0 0x10000 0x0 0x11cc0000 0x0 0x10000>;
		interrupts = <0x0 0x49 0x8>;
		mode = <0x2>;
		multipoint = <0x1>;
		num_eps = <0x10>;
		clocks = <0x19 0x6 0x25 0x3c 0x25 0x1e>;
		clock-names = "usb0", "usb0_clk_top_sel", "usb0_clk_univpll3_d4";
	};

	btcvsd@10001000 {
		compatible = "mediatek,audio_bt_cvsd";
		offset = <0xf00 0x800 0xfd0 0xfd4 0xfd8>;
		reg = <0x0 0x10001000 0x0 0x1000 0x0 0x18000000 0x0 0x10000 0x0 0x18080000 0x0 0x8000>;
		interrupts = <0x0 0xe8 0x8>;
	};

	audio@11220000 {
		compatible = "mediatek,audio", "syscon";
		reg = <0x0 0x11220000 0x0 0x1000>;
		#clock-cells = <0x1>;
		linux,phandle = <0x31>;
		phandle = <0x31>;
	};

	mt_soc_dl1_pcm@11220000 {
		compatible = "mediatek,mt_soc_pcm_dl1";
		reg = <0x0 0x11220000 0x0 0x1000>;
		interrupts = <0x0 0x99 0x8>;
		clocks = <0x31 0x0 0x31 0x4 0x31 0x5 0x31 0x3 0x31 0x1 0x31 0x2 0x31 0x6 0x19 0x2d 0x19 0x35 0x25 0x34 0x25 0x35 0x25 0x3 0x25 0x38 0x25 0x24 0x25 0x42 0x25 0x27 0x32 0x6 0x26>;
		clock-names = "aud_afe_clk", "aud_dac_clk", "aud_dac_predis_clk", "aud_adc_clk", "aud_apll22m_clk", "aud_apll1_tuner_clk", "aud_tml_clk", "aud_infra_clk", "mtkaif_26m_clk", "top_mux_audio", "top_mux_audio_int", "top_sys_pll1_d4", "top_mux_aud_1", "top_apll1_ck", "top_mux_aud_eng1", "top_apll1_d8", "apmixed_apll1", "top_clk26m_clk";
		linux,phandle = <0x4d>;
		phandle = <0x4d>;
	};

	audio_sram@11221000 {
		compatible = "mediatek,audio_sram";
		reg = <0x0 0x11221000 0x0 0x9000>;
	};

	mt_soc_btcvsd_rx_pcm {
		compatible = "mediatek,mt_soc_btcvsd_rx_pcm";
	};

	mt_soc_btcvsd_tx_pcm {
		compatible = "mediatek,mt_soc_btcvsd_tx_pcm";
	};

	mt_soc_deep_buffer_dl_pcm {
		compatible = "mediatek,mt_soc_pcm_deep_buffer_dl";
	};

	mt_soc_ul1_pcm {
		compatible = "mediatek,mt_soc_pcm_capture";
	};

	mt_soc_voice_md1 {
		compatible = "mediatek,mt_soc_pcm_voice_md1";
	};

	mt_soc_hdmi_pcm {
		compatible = "mediatek,mt_soc_pcm_hdmi";
	};

	mt_soc_uldlloopback_pcm {
		compatible = "mediatek,mt_soc_pcm_uldlloopback";
	};

	mt_soc_i2s0_pcm {
		compatible = "mediatek,mt_soc_pcm_dl1_i2s0";
	};

	mt_soc_mrgrx_pcm {
		compatible = "mediatek,mt_soc_pcm_mrgrx";
	};

	mt_soc_mrgrx_awb_pcm {
		compatible = "mediatek,mt_soc_pcm_mrgrx_awb";
	};

	mt_soc_fm_i2s_pcm {
		compatible = "mediatek,mt_soc_pcm_fm_i2s";
	};

	mt_soc_fm_i2s_awb_pcm {
		compatible = "mediatek,mt_soc_pcm_fm_i2s_awb";
	};

	mt_soc_i2s0dl1_pcm {
		compatible = "mediatek,mt_soc_pcm_dl1_i2s0dl1";
	};

	mt_soc_dl1_awb_pcm {
		compatible = "mediatek,mt_soc_pcm_dl1_awb";
	};

	mt_soc_voice_md1_bt {
		compatible = "mediatek,mt_soc_pcm_voice_md1_bt";
	};

	mt_soc_voip_bt_out {
		compatible = "mediatek,mt_soc_pcm_dl1_bt";
	};

	mt_soc_voip_bt_in {
		compatible = "mediatek,mt_soc_pcm_bt_dai";
	};

	mt_soc_tdmrx_pcm {
		compatible = "mediatek,mt_soc_tdm_capture";
	};

	mt_soc_fm_mrgtx_pcm {
		compatible = "mediatek,mt_soc_pcm_fmtx";
	};

	mt_soc_ul2_pcm {
		compatible = "mediatek,mt_soc_pcm_capture2";
	};

	mt_soc_i2s0_awb_pcm {
		compatible = "mediatek,mt_soc_pcm_i2s0_awb";
	};

	mt_soc_voice_md2 {
		compatible = "mediatek,mt_soc_pcm_voice_md2";
	};

	mt_soc_routing_pcm {
		compatible = "mediatek,mt_soc_pcm_routing";
	};

	mt_soc_voice_md2_bt {
		compatible = "mediatek,mt_soc_pcm_voice_md2_bt";
	};

	mt_soc_hp_impedance_pcm {
		compatible = "mediatek,mt_soc_pcm_hp_impedance";
	};

	mt_soc_codec_name {
		compatible = "mediatek,mt_soc_codec_63xx";
		use_hp_depop_flow = <0x0>;
		use_ul_260k = <0x0>;
	};

	mt_soc_dummy_pcm {
		compatible = "mediatek,mt_soc_pcm_dummy";
	};

	mt_soc_codec_dummy_name {
		compatible = "mediatek,mt_soc_codec_dummy";
	};

	mt_soc_routing_dai_name {
		compatible = "mediatek,mt_soc_dai_routing";
	};

	mt_soc_dai_name {
		compatible = "mediatek,mt_soc_dai_stub";
	};

	mt_soc_dl2_pcm {
		compatible = "mediatek,mt_soc_pcm_dl2";
	};

	mt_soc_anc_pcm {
		compatible = "mediatek,mt_soc_pcm_anc";
	};

	mt_soc_pcm_voice_ultra {
		compatible = "mediatek,mt_soc_pcm_voice_ultra";
	};

	mt_soc_pcm_voice_usb {
		compatible = "mediatek,mt_soc_pcm_voice_usb";
	};

	mt_soc_pcm_voice_usb_echoref {
		compatible = "mediatek,mt_soc_pcm_voice_usb_echoref";
	};

	wifi@180f0000 {
		compatible = "mediatek,wifi";
		reg = <0x0 0x180f0000 0x0 0x5c>;
		interrupts = <0x0 0xea 0x8>;
		dma_addrmask = <0x24>;
		clocks = <0x19 0x28>;
		clock-names = "wifi-dma";
	};

	efusec@11c00000 {
		compatible = "mediatek,efusec";
		reg = <0x0 0x11c00000 0x0 0x10000>;
	};

	mipi_rx_ana_csi0@11c10000 {
		compatible = "mediatek,mipi_rx_ana_csi0";
		reg = <0x0 0x11c10000 0x0 0x10000>;
	};

	mipi_rx_ana_csi1@11c20000 {
		compatible = "mediatek,mipi_rx_ana_csi1";
		reg = <0x0 0x11c20000 0x0 0x10000>;
	};

	msdc1_pad_macro@11c40000 {
		compatible = "mediatek,msdc1_pad_macro";
		reg = <0x0 0x11c40000 0x0 0x10000>;
	};

	msdc0_pad_macro@11cd0000 {
		compatible = "mediatek,msdc0_pad_macro";
		reg = <0x0 0x11cd0000 0x0 0x10000>;
	};

	mfg_auckland@13000000 {
		compatible = "mediatek,AUCKLAND";
		reg = <0x0 0x13000000 0x0 0x80000>;
		interrupts = <0x0 0xe2 0x8>;
		interrupt-names = "RGX";
		clock-frequency = <0x21f98280>;
		clocks = <0x25 0x2d 0x26 0x25 0x20 0x1a 0x0 0x1a 0x1>;
		clock-names = "CLK_TOP_MFG", "CLK_TOP_MFG_OFF", "CLK_TOP_MFG_ON", "CG_SCP_SYS_MFG0", "CG_SCP_SYS_MFG1";
	};

	mfg_cfg@13ffe000 {
		compatible = "mediatek,mt6739-mfg_cfg", "syscon";
		reg = <0x0 0x13ffe000 0x0 0x1000>;
	};

	gpufreq {
		compatible = "mediatek,mt6739-gpufreq";
		clocks = <0x25 0x2d 0x26 0x25 0x20>;
		clock-names = "CLK_TOP_MFG", "CLK_TOP_MFG_OFF", "CLK_TOP_MFG_ON";
	};

	mmsys_config@14000000 {
		compatible = "mediatek,mmsys_config", "syscon";
		reg = <0x0 0x14000000 0x0 0x1000>;
		interrupts = <0x0 0xd3 0x8>;
		#clock-cells = <0x1>;
		clocks = <0x1b 0x4>;
		clock-names = "CAM_MDP";
		linux,phandle = <0x1b>;
		phandle = <0x1b>;
	};

	touch {
		compatible = "mediatek,mt6739-touch";
		linux,phandle = <0x4e>;
		phandle = <0x4e>;
	};

	dummy_camera@ {
		compatible = "mediatek,dummy_camera";
		linux,phandle = <0x4f>;
		phandle = <0x4f>;
	};

	flashlight_core {
		compatible = "mediatek,flashlight_core";
		linux,phandle = <0x50>;
		phandle = <0x50>;
	};

	flashlights_rt4505 {
		compatible = "mediatek,flashlights_rt4505";
		linux,phandle = <0x51>;
		phandle = <0x51>;
	};

	flashlight_main {
		compatible = "mediatek,flashlights_dummy_gpio";
		linux,phandle = <0x52>;
		phandle = <0x52>;
	};

	flashlight_sub {
		compatible = "mediatek,flashlights_sub_dummy_gpio";
		linux,phandle = <0x53>;
		phandle = <0x53>;
	};

	mtkfb {
		compatible = "mediatek,mtkfb";
		linux,phandle = <0x54>;
		phandle = <0x54>;
	};

	disp_mutex@14001000 {
		compatible = "mediatek,disp_mutex";
		reg = <0x0 0x14001000 0x0 0x1000>;
		interrupts = <0x0 0xc2 0x8>;
		linux,phandle = <0x23>;
		phandle = <0x23>;
	};

	smi_common@14002000 {
		compatible = "mediatek,smi_common";
		reg = <0x0 0x14002000 0x0 0x1000>;
		larbs = <0x33 0x34 0x35>;
		clocks = <0x1a 0x4 0x1b 0x2 0x1b 0x3 0x1b 0x0 0x25 0x2c 0x25 0x21 0x25 0x7>;
		clock-names = "mtcmos-mm", "smi-common-gals0", "smi-common-gals1", "smi-common", "MMDVFS_CLK_TOP_MMPLL_CK", "mmdvfs_clk_top_vencpll_ck", "mmdvfs_clk_top_syspll2_d2";
	};

	smi_larb0@14003000 {
		compatible = "mediatek,smi_larb0";
		reg = <0x0 0x14003000 0x0 0x1000>;
		interrupts = <0x0 0xdf 0x8>;
		clocks = <0x1a 0x4 0x1b 0x1>;
		clock-names = "mtcmos-mm", "mm-larb0";
		linux,phandle = <0x33>;
		phandle = <0x33>;
	};

	mdp_rdma0@14004000 {
		compatible = "mediatek,mdp_rdma0";
		reg = <0x0 0x14004000 0x0 0x1000>;
		interrupts = <0x0 0xc3 0x8>;
		clocks = <0x1b 0x5>;
		clock-names = "MDP_RDMA0";
		linux,phandle = <0x1c>;
		phandle = <0x1c>;
	};

	mdp_rsz0@14005000 {
		compatible = "mediatek,mdp_rsz0";
		reg = <0x0 0x14005000 0x0 0x1000>;
		interrupts = <0x0 0xc4 0x8>;
		clocks = <0x1b 0x6>;
		clock-names = "MDP_RSZ0";
		linux,phandle = <0x1d>;
		phandle = <0x1d>;
	};

	mdp_rsz1@14006000 {
		compatible = "mediatek,mdp_rsz1";
		reg = <0x0 0x14006000 0x0 0x1000>;
		interrupts = <0x0 0xc5 0x8>;
		clocks = <0x1b 0x7>;
		clock-names = "MDP_RSZ1";
		linux,phandle = <0x1e>;
		phandle = <0x1e>;
	};

	mdp_wdma0@14007000 {
		compatible = "mediatek,mdp_wdma0";
		reg = <0x0 0x14007000 0x0 0x1000>;
		interrupts = <0x0 0xc8 0x8>;
		clocks = <0x1b 0xa>;
		clock-names = "MDP_WDMA";
		linux,phandle = <0x1f>;
		phandle = <0x1f>;
	};

	mdp_wrot0@14008000 {
		compatible = "mediatek,mdp_wrot0";
		reg = <0x0 0x14008000 0x0 0x1000>;
		interrupts = <0x0 0xc7 0x8>;
		clocks = <0x1b 0x9>;
		clock-names = "MDP_WROT0";
		linux,phandle = <0x20>;
		phandle = <0x20>;
	};

	mdp_tdshp0@14009000 {
		compatible = "mediatek,mdp_tdshp0";
		reg = <0x0 0x14009000 0x0 0x1000>;
		clocks = <0x1b 0x8>;
		clock-names = "MDP_TDSHP";
		linux,phandle = <0x21>;
		phandle = <0x21>;
	};

	disp_ovl0@1400a000 {
		compatible = "mediatek,disp_ovl0";
		reg = <0x0 0x1400a000 0x0 0x1000>;
		interrupts = <0x0 0xc9 0x8>;
		clocks = <0x1b 0xc>;
		clock-names = "DISP_OVL0";
		linux,phandle = <0x22>;
		phandle = <0x22>;
	};

	disp_rdma0@1400b000 {
		compatible = "mediatek,disp_rdma0";
		reg = <0x0 0x1400b000 0x0 0x1000>;
		interrupts = <0x0 0xca 0x8>;
	};

	disp_wdma0@1400c000 {
		compatible = "mediatek,disp_wdma0";
		reg = <0x0 0x1400c000 0x0 0x1000>;
		interrupts = <0x0 0xcb 0x8>;
	};

	disp_color0@1400d000 {
		compatible = "mediatek,disp_color0";
		reg = <0x0 0x1400d000 0x0 0x1000>;
		interrupts = <0x0 0xcc 0x8>;
	};

	disp_ccorr0@1400e000 {
		compatible = "mediatek,disp_ccorr0";
		reg = <0x0 0x1400e000 0x0 0x1000>;
		interrupts = <0x0 0xcd 0x8>;
	};

	disp_aal0@1400f000 {
		compatible = "mediatek,disp_aal0";
		reg = <0x0 0x1400f000 0x0 0x1000>;
		interrupts = <0x0 0xce 0x8>;
		aal_support = <0x1>;
		linux,phandle = <0x55>;
		phandle = <0x55>;
	};

	disp_gamma0@14010000 {
		compatible = "mediatek,disp_gamma0";
		reg = <0x0 0x14010000 0x0 0x1000>;
		interrupts = <0x0 0xcf 0x8>;
	};

	disp_dither0@14011000 {
		compatible = "mediatek,disp_dither0";
		reg = <0x0 0x14011000 0x0 0x1000>;
		interrupts = <0x0 0xd0 0x8>;
	};

	dsi0@14012000 {
		compatible = "mediatek,dsi0";
		reg = <0x0 0x14012000 0x0 0x1000>;
		interrupts = <0x0 0xd1 0x8>;
	};

	dispsys@14000000 {
		compatible = "mediatek,dispsys";
		clocks = <0x1a 0x4 0x1b 0x0 0x1b 0x1 0x1b 0x2 0x1b 0x3 0x1b 0xc 0x1b 0xd 0x1b 0xe 0x1b 0xf 0x1b 0x10 0x1b 0x11 0x1b 0x12 0x1b 0x13 0x1b 0x14 0x1b 0x15 0x1b 0x18 0x1b 0x9 0x19 0x33 0x25 0x39 0x26 0x25 0x19 0x25 0x1a 0x25 0x1f>;
		clock-names = "CLK_MM_MTCMOS", "CLK_MM_SMI_COMMON", "CLK_MM_SMI_LARB0", "CLK_MM_GALS_COMM0", "CLK_MM_GALS_COMM1", "CLK_MM_DISP_OVL0", "CLK_MM_DISP_RDMA0", "CLK_MM_DISP_WDMA0", "CLK_MM_DISP_COLOR0", "CLK_MM_DISP_CCORR0", "CLK_MM_DISP_AAL0", "CLK_MM_DISP_GAMMA0", "CLK_MM_DISP_DITHER0", "CLK_MM_DSI_MM_CLOCK", "CLK_MM_DSI_INTERF", "CLK_MM_F26M_HRT", "MDP_WROT0", "DISP_PWM", "MUX_PWM", "CLK26M", "UNIVPLL2_D4", "UNIVPLL2_D8", "UNIVPLL3_D8";
		linux,phandle = <0x56>;
		phandle = <0x56>;
	};

	dbi0@14013000 {
		compatible = "mediatek,dbi0";
		reg = <0x0 0x14013000 0x0 0x1000>;
		interrupts = <0x0 0xd2 0x8>;
	};

	mm_mutex@14016000 {
		compatible = "mediatek,mm_mutex";
		reg = <0x0 0x14016000 0x0 0x0>;
		linux,phandle = <0x57>;
		phandle = <0x57>;
	};

	imgsys_config@15000000 {
		compatible = "mediatek,imgsys", "syscon";
		reg = <0x0 0x15000000 0x0 0x1000>;
		#clock-cells = <0x1>;
		linux,phandle = <0x36>;
		phandle = <0x36>;
	};

	ispsys@15000000 {
		compatible = "mediatek,mt6739-ispsys";
		reg = <0x0 0x15004000 0x0 0x9000 0x0 0x1500d000 0x0 0x1000 0x0 0x15000000 0x0 0x10000 0x0 0x10215000 0x0 0x3000 0x0 0x10211000 0x0 0x1000>;
		interrupts = <0x0 0xd9 0x8 0x0 0xda 0x8 0x0 0xdb 0x8 0x0 0xdc 0x8 0x0 0xdd 0x8>;
		clocks = <0x1a 0x4 0x1a 0x5 0x36 0x1 0x36 0x2 0x36 0x3 0x36 0x4 0x36 0x5>;
		clock-names = "CG_SCP_SYS_MM0", "CG_SCP_SYS_ISP", "CG_IMG_CAM_SMI", "CG_IMG_CAM_CAM", "CG_IMG_SEN_TG", "CG_IMG_SEN_CAM", "CG_IMG_CAM_SV";
	};

	smi_larb2@15001000 {
		compatible = "mediatek,smi_larb2";
		reg = <0x0 0x15001000 0x0 0x1000>;
		interrupts = <0x0 0xde 0x8>;
		clocks = <0x1a 0x5 0x36 0x0>;
		clock-names = "mtcmos-img", "img-larb2";
		linux,phandle = <0x35>;
		phandle = <0x35>;
	};

	cam_a@15004000 {
		compatible = "mediatek,cam_a";
		reg = <0x0 0x15004000 0x0 0x1000>;
	};

	cam_b@15005000 {
		compatible = "mediatek,cam_b";
		reg = <0x0 0x15005000 0x0 0x1000>;
		interrupts = <0x0 0xd9 0x8>;
	};

	cam_c@15006000 {
		compatible = "mediatek,cam_c";
		reg = <0x0 0x15006000 0x0 0x1000>;
		interrupts = <0x0 0xda 0x8>;
	};

	cam_d@15007000 {
		compatible = "mediatek,cam_d";
		reg = <0x0 0x15007000 0x0 0x1000>;
		interrupts = <0x0 0xdb 0x8>;
	};

	seninf@15008000 {
		compatible = "mediatek,seninf";
		reg = <0x0 0x15008000 0x0 0x1000>;
	};

	camsv@15009000 {
		compatible = "mediatek,camsv";
		reg = <0x0 0x15009000 0x0 0x1000>;
		interrupts = <0x0 0xdc 0x8>;
	};

	cam_a_inner@1500d000 {
		compatible = "mediatek,cam_a_inner";
		reg = <0x0 0x1500d000 0x0 0x1000>;
	};

	cam_c_inner@1500e000 {
		compatible = "mediatek,cam_c_inner";
		reg = <0x0 0x1500e000 0x0 0x1000>;
	};

	cam_d_inner@1500f000 {
		compatible = "mediatek,cam_d_inner";
		reg = <0x0 0x1500f000 0x0 0x1000>;
	};

	venc_global_con@17000000 {
		compatible = "mediatek,venc_global_con", "syscon";
		reg = <0x0 0x17000000 0x0 0x10000>;
		#clock-cells = <0x1>;
		linux,phandle = <0x37>;
		phandle = <0x37>;
	};

	vdec_gcon@17000000 {
		compatible = "mediatek,vdec_gcon";
		reg = <0x0 0x17000000 0x0 0x1000>;
		clocks = <0x37 0x3 0x37 0x1 0x1a 0x6 0x1a 0x6>;
		clock-names = "MT_CG_VDEC", "MT_CG_VENC", "MT_SCP_SYS_VDE", "MT_SCP_SYS_VEN";
	};

	venc_jpg@17030000 {
		compatible = "mediatek,venc_jpg";
		reg = <0x0 0x17030000 0x0 0x1000>;
		interrupts = <0x0 0xd6 0x8>;
		clocks = <0x37 0x2>;
		clock-names = "MT_CG_VENC_JPGENC";
	};

	vdec@17040000 {
		compatible = "mediatek,vdec";
		reg = <0x0 0x17040000 0x0 0x10000>;
		interrupts = <0x0 0xd7 0x8>;
	};

	smi_larb3@17010000 {
		compatible = "mediatek,smi_larb3";
		reg = <0x0 0x17010000 0x0 0x1000>;
		interrupts = <0x0 0xe7 0x8>;
	};

	venc@17020000 {
		compatible = "mediatek,venc";
		reg = <0x0 0x17020000 0x0 0x1000>;
		interrupts = <0x0 0xd4 0x8>;
		linux,phandle = <0x58>;
		phandle = <0x58>;
	};

	smi_larb1@17010000 {
		compatible = "mediatek,smi_larb1";
		reg = <0x0 0x17010000 0x0 0x1000>;
		interrupts = <0x0 0xd5 0x8>;
		clocks = <0x1a 0x6 0x37 0x0 0x37 0x1>;
		clock-names = "mtcmos-ven", "venc-larb", "venc-venc";
		linux,phandle = <0x34>;
		phandle = <0x34>;
	};

	mt6357_gauge {
		compatible = "mediatek,mt6357_gauge";
		gauge_name = "gauge";
		alias_name = "mt6357";
	};

	gauge_timer {
		compatible = "mediatek,gauge_timer_service";
	};

	bat_gm30 {
		compatible = "mediatek,bat_gm30";
		DIFFERENCE_FULLOCV_ITH = <0xc8>;
		SHUTDOWN_1_TIME = <0x3c>;
		KEEP_100_PERCENT = <0x2>;
		R_FG_VALUE = <0xa>;
		EMBEDDED_SEL = <0x0>;
		PMIC_SHUTDOWN_CURRENT = <0x14>;
		FG_METER_RESISTANCE = <0x4b>;
		CAR_TUNE_VALUE = <0x64>;
		TEMPERATURE_T0 = <0x32>;
		TEMPERATURE_T1 = <0x19>;
		TEMPERATURE_T2 = <0xa>;
		TEMPERATURE_T3 = <0x0>;
		TEMPERATURE_T4 = <0xfffffff6>;
		g_FG_PSEUDO100_T0 = <0x62>;
		g_FG_PSEUDO100_T1 = <0x62>;
		g_FG_PSEUDO100_T2 = <0x5f>;
		g_FG_PSEUDO100_T3 = <0x5a>;
		g_FG_PSEUDO100_T4 = <0x50>;
		Q_MAX_SYS_VOLTAGE_BAT0 = <0xd7a>;
		Q_MAX_SYS_VOLTAGE_BAT1 = <0xd7a>;
		Q_MAX_SYS_VOLTAGE_BAT2 = <0xd7a>;
		Q_MAX_SYS_VOLTAGE_BAT3 = <0xd7a>;
		battery0_profile_t0_num = <0x64>;
		battery0_profile_t0 = <0x0 0xab74 0x500 0x147 0xab05 0x4ee 0x28f 0xaa9b 0x4e9 0x3d6 0xaa35 0x4ed 0x51d 0xa9cd 0x4ec 0x664 0xa962 0x4e0 0x7ac 0xa8f8 0x4e6 0x8f3 0xa88d 0x4f2 0xa3a 0xa81c 0x4ea 0xb81 0xa7a8 0x4e5 0xcc9 0xa736 0x4ed 0xe10 0xa6c1 0x4e7 0xf57 0xa64f 0x4f5 0x109f 0xa5db 0x4f7 0x11e6 0xa566 0x4f7 0x132d 0xa4f2 0x4f6 0x1474 0xa47d 0x4ef 0x15bc 0xa408 0x4f5 0x1703 0xa398 0x503 0x184a 0xa327 0x506 0x1991 0xa2b4 0x506 0x1ad9 0xa243 0x507 0x1c20 0xa1d3 0x505 0x1d67 0xa166 0x513 0x1eaf 0xa0f7 0x517 0x1ff6 0xa08b 0x517 0x213d 0xa021 0x51b 0x2284 0x9fb8 0x526 0x23cc 0x9f4e 0x52c 0x2513 0x9ee6 0x532 0x265a 0x9e81 0x534 0x27a1 0x9e1f 0x53d 0x28e9 0x9dbf 0x54d 0x2a30 0x9d5f 0x555 0x2b77 0x9cfc 0x561 0x2cbf 0x9c9f 0x56e 0x2e06 0x9c45 0x57b 0x2f4d 0x9bed 0x588 0x3094 0x9b96 0x594 0x31dc 0x9b41 0x5af 0x3323 0x9ae3 0x5bc 0x346a 0x9a7a 0x5b0 0x35b1 0x9a00 0x58c 0x36f9 0x9979 0x552 0x3840 0x98f0 0x500 0x3987 0x988d 0x4f8 0x3acf 0x9836 0x4ee 0x3c16 0x97e8 0x4e2 0x3d5d 0x97a1 0x4d8 0x3ea4 0x975f 0x4d7 0x3fec 0x971d 0x4d1 0x4133 0x96e2 0x4d6 0x427a 0x96a7 0x4dc 0x43c1 0x966f 0x4e2 0x4509 0x963b 0x4e8 0x4650 0x9608 0x4ef 0x4797 0x95d5 0x4ef 0x48df 0x95a4 0x4ef 0x4a26 0x9577 0x4f5 0x4b6d 0x954b 0x500 0x4cb4 0x951e 0x505 0x4dfc 0x94f5 0x507 0x4f43 0x94cf 0x518 0x508a 0x94a9 0x522 0x51d1 0x9483 0x528 0x5319 0x945e 0x530 0x5460 0x943d 0x53c 0x55a7 0x941c 0x550 0x56ef 0x93f9 0x54f 0x5836 0x93ce 0x548 0x597d 0x9398 0x537 0x5ac4 0x9356 0x513 0x5c0c 0x9309 0x4f4 0x5d53 0x92d2 0x4f1 0x5e9a 0x92a0 0x4f5 0x5fe1 0x9271 0x4fb 0x6129 0x9242 0x500 0x6270 0x9212 0x4fe 0x63b7 0x91e2 0x4f1 0x64ff 0x91bc 0x4fa 0x6646 0x9197 0x506 0x678d 0x916d 0x50a 0x68d4 0x913b 0x504 0x6a1c 0x90fc 0x4fa 0x6b63 0x90be 0x4f7 0x6caa 0x9083 0x4fe 0x6df1 0x9040 0x4fd 0x6f39 0x8ff6 0x4e8 0x7080 0x8fb9 0x4c9 0x71c7 0x8fac 0x4e2 0x730f 0x8fa1 0x500 0x7456 0x8f96 0x523 0x759d 0x8f85 0x551 0x76e4 0x8f69 0x58d 0x782c 0x8f26 0x5ae 0x7973 0x8e28 0x55e 0x7aba 0x8c9c 0x54b 0x7c01 0x8a87 0x56b 0x7d49 0x87ef 0x5fa 0x7e90 0x86c4 0x7d0>;
		battery0_profile_t1_num = <0x64>;
		battery0_profile_t1 = <0x0 0xab6e 0x562 0x147 0xaafb 0x51c 0x28f 0xaa91 0x513 0x3d6 0xaa2b 0x516 0x51d 0xa9c4 0x51d 0x664 0xa95b 0x52c 0x7ac 0xa8ea 0x51f 0x8f3 0xa877 0x519 0xa3a 0xa804 0x512 0xb81 0xa790 0x512 0xcc9 0xa71d 0x518 0xe10 0xa6a8 0x51e 0xf57 0xa636 0x52a 0x109f 0xa5c2 0x532 0x11e6 0xa54f 0x540 0x132d 0xa4dd 0x551 0x1474 0xa46a 0x55a 0x15bc 0xa3f9 0x555 0x1703 0xa388 0x55e 0x184a 0xa319 0x56f 0x1991 0xa2ab 0x584 0x1ad9 0xa23e 0x597 0x1c20 0xa1d0 0x5a7 0x1d67 0xa161 0x5aa 0x1eaf 0xa0f3 0x5af 0x1ff6 0xa089 0x5b9 0x213d 0xa021 0x5cb 0x2284 0x9fb9 0x5e0 0x23cc 0x9f57 0x5ee 0x2513 0x9efd 0x600 0x265a 0x9ea0 0x613 0x27a1 0x9e3d 0x622 0x28e9 0x9dd2 0x62e 0x2a30 0x9d68 0x636 0x2b77 0x9d03 0x64f 0x2cbf 0x9c9f 0x66c 0x2e06 0x9c3f 0x680 0x2f4d 0x9be3 0x68f 0x3094 0x9b8b 0x6a4 0x31dc 0x9b36 0x6b6 0x3323 0x9ae1 0x6ad 0x346a 0x9a71 0x672 0x35b1 0x99e7 0x612 0x36f9 0x9955 0x5af 0x3840 0x98e0 0x582 0x3987 0x9883 0x569 0x3acf 0x9833 0x55a 0x3c16 0x97e9 0x552 0x3d5d 0x97a4 0x54d 0x3ea4 0x9762 0x54b 0x3fec 0x9726 0x546 0x4133 0x96ee 0x54b 0x427a 0x96b4 0x548 0x43c1 0x967c 0x546 0x4509 0x964a 0x54a 0x4650 0x961a 0x544 0x4797 0x95eb 0x54c 0x48df 0x95bc 0x557 0x4a26 0x9590 0x560 0x4b6d 0x9565 0x568 0x4cb4 0x953d 0x575 0x4dfc 0x9517 0x587 0x4f43 0x94f4 0x596 0x508a 0x94d0 0x59e 0x51d1 0x94ad 0x5a9 0x5319 0x948c 0x5b7 0x5460 0x9468 0x5af 0x55a7 0x944c 0x5ca 0x56ef 0x942d 0x5d4 0x5836 0x9407 0x5cd 0x597d 0x93de 0x5bc 0x5ac4 0x93b2 0x5ad 0x5c0c 0x937d 0x589 0x5d53 0x934e 0x583 0x5e9a 0x9322 0x582 0x5fe1 0x92f5 0x57d 0x6129 0x92c4 0x570 0x6270 0x9294 0x564 0x63b7 0x9269 0x564 0x64ff 0x9248 0x56e 0x6646 0x9226 0x57a 0x678d 0x9200 0x584 0x68d4 0x91d1 0x589 0x6a1c 0x9196 0x583 0x6b63 0x9159 0x57d 0x6caa 0x9120 0x583 0x6df1 0x90df 0x58a 0x6f39 0x9094 0x582 0x7080 0x904d 0x562 0x71c7 0x902a 0x549 0x730f 0x9014 0x54d 0x7456 0x8fff 0x559 0x759d 0x8fec 0x571 0x76e4 0x8fdd 0x5a3 0x782c 0x8fb6 0x5ed 0x7973 0x8f03 0x5b9 0x7aba 0x8dab 0x59d 0x7c01 0x8bd1 0x5c0 0x7d49 0x892e 0x574 0x7e90 0x86c4 0x2e2>;
		battery0_profile_t2_num = <0x64>;
		battery0_profile_t2 = <0x0 0xab6e 0x562 0x147 0xaafb 0x51c 0x28f 0xaa91 0x513 0x3d6 0xaa2b 0x516 0x51d 0xa9c4 0x51d 0x664 0xa95b 0x52c 0x7ac 0xa8ea 0x51f 0x8f3 0xa877 0x519 0xa3a 0xa804 0x512 0xb81 0xa790 0x512 0xcc9 0xa71d 0x518 0xe10 0xa6a8 0x51e 0xf57 0xa636 0x52a 0x109f 0xa5c2 0x532 0x11e6 0xa54f 0x540 0x132d 0xa4dd 0x551 0x1474 0xa46a 0x55a 0x15bc 0xa3f9 0x555 0x1703 0xa388 0x55e 0x184a 0xa319 0x56f 0x1991 0xa2ab 0x584 0x1ad9 0xa23e 0x597 0x1c20 0xa1d0 0x5a7 0x1d67 0xa161 0x5aa 0x1eaf 0xa0f3 0x5af 0x1ff6 0xa089 0x5b9 0x213d 0xa021 0x5cb 0x2284 0x9fb9 0x5e0 0x23cc 0x9f57 0x5ee 0x2513 0x9efd 0x600 0x265a 0x9ea0 0x613 0x27a1 0x9e3d 0x622 0x28e9 0x9dd2 0x62e 0x2a30 0x9d68 0x636 0x2b77 0x9d03 0x64f 0x2cbf 0x9c9f 0x66c 0x2e06 0x9c3f 0x680 0x2f4d 0x9be3 0x68f 0x3094 0x9b8b 0x6a4 0x31dc 0x9b36 0x6b6 0x3323 0x9ae1 0x6ad 0x346a 0x9a71 0x672 0x35b1 0x99e7 0x612 0x36f9 0x9955 0x5af 0x3840 0x98e0 0x582 0x3987 0x9883 0x569 0x3acf 0x9833 0x55a 0x3c16 0x97e9 0x552 0x3d5d 0x97a4 0x54d 0x3ea4 0x9762 0x54b 0x3fec 0x9726 0x546 0x4133 0x96ee 0x54b 0x427a 0x96b4 0x548 0x43c1 0x967c 0x546 0x4509 0x964a 0x54a 0x4650 0x961a 0x544 0x4797 0x95eb 0x54c 0x48df 0x95bc 0x557 0x4a26 0x9590 0x560 0x4b6d 0x9565 0x568 0x4cb4 0x953d 0x575 0x4dfc 0x9517 0x587 0x4f43 0x94f4 0x596 0x508a 0x94d0 0x59e 0x51d1 0x94ad 0x5a9 0x5319 0x948c 0x5b7 0x5460 0x9468 0x5af 0x55a7 0x944c 0x5ca 0x56ef 0x942d 0x5d4 0x5836 0x9407 0x5cd 0x597d 0x93de 0x5bc 0x5ac4 0x93b2 0x5ad 0x5c0c 0x937d 0x589 0x5d53 0x934e 0x583 0x5e9a 0x9322 0x582 0x5fe1 0x92f5 0x57d 0x6129 0x92c4 0x570 0x6270 0x9294 0x564 0x63b7 0x9269 0x564 0x64ff 0x9248 0x56e 0x6646 0x9226 0x57a 0x678d 0x9200 0x584 0x68d4 0x91d1 0x589 0x6a1c 0x9196 0x583 0x6b63 0x9159 0x57d 0x6caa 0x9120 0x583 0x6df1 0x90df 0x58a 0x6f39 0x9094 0x582 0x7080 0x904d 0x562 0x71c7 0x902a 0x549 0x730f 0x9014 0x54d 0x7456 0x8fff 0x559 0x759d 0x8fec 0x571 0x76e4 0x8fdd 0x5a3 0x782c 0x8fb6 0x5ed 0x7973 0x8f03 0x5b9 0x7aba 0x8dab 0x59d 0x7c01 0x8bd1 0x5c0 0x7d49 0x892e 0x574 0x7e90 0x86c4 0x2e2>;
		battery0_profile_t3_num = <0x64>;
		battery0_profile_t3 = <0x0 0xab3c 0x1043 0x147 0xaa8d 0x1705 0x28f 0xa9f0 0x186c 0x3d6 0xa95d 0x1838 0x51d 0xa8d0 0x17ed 0x664 0xa842 0x1792 0x7ac 0xa7bc 0x172e 0x8f3 0xa73c 0x16e5 0xa3a 0xa6bf 0x169a 0xb81 0xa643 0x164a 0xcc9 0xa5c7 0x15fb 0xe10 0xa550 0x15b6 0xf57 0xa4d6 0x1562 0x109f 0xa461 0x1529 0x11e6 0xa3ec 0x14eb 0x132d 0xa379 0x14ab 0x1474 0xa30a 0x147b 0x15bc 0xa299 0x144e 0x1703 0xa22a 0x141b 0x184a 0xa1bc 0x13fa 0x1991 0xa14e 0x13c4 0x1ad9 0xa0df 0x1381 0x1c20 0xa075 0x138f 0x1d67 0xa014 0x1375 0x1eaf 0x9fb5 0x137a 0x1ff6 0x9f53 0x1381 0x213d 0x9eed 0x137e 0x2284 0x9e80 0x136e 0x23cc 0x9dfe 0x1322 0x2513 0x9d6d 0x12bf 0x265a 0x9cde 0x1266 0x27a1 0x9c56 0x121a 0x28e9 0x9bd8 0x11da 0x2a30 0x9b65 0x11ad 0x2b77 0x9b00 0x117a 0x2cbf 0x9a9e 0x114d 0x2e06 0x9a3f 0x111a 0x2f4d 0x99e3 0x10e9 0x3094 0x998b 0x10c8 0x31dc 0x9937 0x10a3 0x3323 0x98e4 0x107e 0x346a 0x988e 0x105c 0x35b1 0x983b 0x1042 0x36f9 0x97ee 0x102e 0x3840 0x97a4 0x1013 0x3987 0x975d 0x100d 0x3acf 0x9718 0x1002 0x3c16 0x96d8 0xffd 0x3d5d 0x969c 0x1001 0x3ea4 0x9662 0x100b 0x3fec 0x962a 0x100b 0x4133 0x95f3 0x100d 0x427a 0x95be 0x1012 0x43c1 0x958e 0x101e 0x4509 0x9560 0x1030 0x4650 0x9532 0x1043 0x4797 0x9507 0x1055 0x48df 0x94de 0x1064 0x4a26 0x94b5 0x1070 0x4b6d 0x948e 0x1082 0x4cb4 0x946b 0x10a1 0x4dfc 0x944a 0x10b3 0x4f43 0x942d 0x10d3 0x508a 0x9413 0x10fa 0x51d1 0x93fb 0x1129 0x5319 0x93e5 0x115e 0x5460 0x93d4 0x1199 0x55a7 0x93bd 0x11ca 0x56ef 0x93aa 0x1210 0x5836 0x9397 0x124e 0x597d 0x9381 0x1289 0x5ac4 0x936a 0x12d4 0x5c0c 0x9351 0x131a 0x5d53 0x9333 0x135a 0x5e9a 0x9315 0x13a7 0x5fe1 0x92f4 0x13fe 0x6129 0x92d0 0x1458 0x6270 0x92a7 0x14b7 0x63b7 0x9279 0x153b 0x64ff 0x9246 0x15b1 0x6646 0x920c 0x1631 0x678d 0x91ce 0x16c4 0x68d4 0x918c 0x1767 0x6a1c 0x9149 0x183e 0x6b63 0x90fe 0x190f 0x6caa 0x90b4 0x19fe 0x6df1 0x9074 0x1b0d 0x6f39 0x9046 0x1c46 0x7080 0x9025 0x1dc9 0x71c7 0x8fff 0x1f9f 0x730f 0x8fd3 0x21e2 0x7456 0x8f96 0x24ac 0x759d 0x8f2b 0x2804 0x76e4 0x8e64 0x2be7 0x782c 0x8ce6 0x3087 0x7973 0x8ac2 0x350a 0x7aba 0x88ef 0x315d 0x7c01 0x86c4 0x2e2 0x7d49 0x86c4 0x2e2 0x7e90 0x86c4 0x2e2>;
		battery0_profile_t4_num = <0x64>;
		battery0_profile_t4 = <0x0 0xab81 0x238a 0x147 0xaa9f 0x29c3 0x28f 0xa9d5 0x2b43 0x3d6 0xa919 0x2b2a 0x51d 0xa868 0x2ad5 0x664 0xa7c3 0x2a6b 0x7ac 0xa724 0x29f5 0x8f3 0xa68d 0x2987 0xa3a 0xa5fa 0x2923 0xb81 0xa56d 0x28c1 0xcc9 0xa4e5 0x285c 0xe10 0xa45e 0x27f6 0xf57 0xa3dd 0x279c 0x109f 0xa35b 0x2744 0x11e6 0xa2dd 0x26f6 0x132d 0xa261 0x26a7 0x1474 0xa1e5 0x264c 0x15bc 0xa171 0x2615 0x1703 0xa105 0x25e3 0x184a 0xa09d 0x25c1 0x1991 0xa031 0x25a1 0x1ad9 0x9fbe 0x2573 0x1c20 0x9f3f 0x252e 0x1d67 0x9eae 0x24af 0x1eaf 0x9e14 0x2430 0x1ff6 0x9d7b 0x23ae 0x213d 0x9ceb 0x2335 0x2284 0x9c68 0x22d8 0x23cc 0x9bef 0x2292 0x2513 0x9b82 0x2264 0x265a 0x9b1f 0x2244 0x27a1 0x9ac0 0x2225 0x28e9 0x9a64 0x2207 0x2a30 0x9a10 0x21ff 0x2b77 0x99ba 0x21e6 0x2cbf 0x9964 0x21c2 0x2e06 0x990d 0x21a7 0x2f4d 0x98b8 0x2194 0x3094 0x9865 0x2182 0x31dc 0x9810 0x216d 0x3323 0x97c1 0x2155 0x346a 0x9776 0x2151 0x35b1 0x972e 0x2160 0x36f9 0x96e9 0x2178 0x3840 0x96a9 0x2184 0x3987 0x966a 0x217e 0x3acf 0x962e 0x219e 0x3c16 0x95f5 0x21b1 0x3d5d 0x95be 0x21ba 0x3ea4 0x958a 0x21d6 0x3fec 0x955f 0x2201 0x4133 0x9536 0x2240 0x427a 0x9511 0x227b 0x43c1 0x94f0 0x22bc 0x4509 0x94d2 0x2309 0x4650 0x94b6 0x2355 0x4797 0x949d 0x23ad 0x48df 0x9487 0x240b 0x4a26 0x9470 0x2460 0x4b6d 0x9458 0x24b2 0x4cb4 0x9444 0x2513 0x4dfc 0x9433 0x258e 0x4f43 0x941d 0x25fa 0x508a 0x9407 0x265e 0x51d1 0x93f4 0x26d6 0x5319 0x93e1 0x2764 0x5460 0x93ca 0x27ce 0x55a7 0x93b6 0x2863 0x56ef 0x93a0 0x28ff 0x5836 0x9389 0x29a4 0x597d 0x9372 0x2a4e 0x5ac4 0x9358 0x2af3 0x5c0c 0x933c 0x2bac 0x5d53 0x9320 0x2c69 0x5e9a 0x9301 0x2d2b 0x5fe1 0x92dd 0x2df6 0x6129 0x92b6 0x2ecb 0x6270 0x928b 0x2fa8 0x63b7 0x9260 0x30b2 0x64ff 0x922f 0x31b7 0x6646 0x91fc 0x32c8 0x678d 0x91c7 0x33dd 0x68d4 0x918c 0x34e6 0x6a1c 0x914c 0x3609 0x6b63 0x9106 0x373d 0x6caa 0x90c3 0x3870 0x6df1 0x9087 0x39b1 0x6f39 0x9057 0x3b0a 0x7080 0x902e 0x3c6e 0x71c7 0x9008 0x3dd8 0x730f 0x8fde 0x3f77 0x7456 0x8fb0 0x4124 0x759d 0x8f76 0x41b0 0x76e4 0x8f13 0x40b9 0x782c 0x8e47 0x3eb9 0x7973 0x8cc9 0x3aff 0x7aba 0x8a8b 0x3562 0x7c01 0x853e 0x6d1 0x7d49 0x86c4 0x2e2 0x7e90 0x86c4 0x2e2>;
		linux,phandle = <0x59>;
		phandle = <0x59>;
	};

	mt_charger {
		compatible = "mediatek,mt-charger";
		linux,phandle = <0x5a>;
		phandle = <0x5a>;
	};

	charger {
		compatible = "mediatek,charger";
		algorithm_name = "SwitchCharging";
		battery_cv = <0x43e6d0>;
		max_charger_voltage = <0x632ea0>;
		min_charger_voltage = <0x4630c0>;
		usb_charger_current_suspend = <0x0>;
		usb_charger_current_unconfigured = <0x11170>;
		usb_charger_current_configured = <0x7a120>;
		usb_charger_current = <0x7a120>;
		ac_charger_current = <0x1f6ee0>;
		ac_charger_input_current = <0x124f80>;
		non_std_ac_charger_current = <0x7a120>;
		charging_host_charger_current = <0x7a120>;
		apple_1_0a_charger_current = <0x9eb10>;
		apple_2_1a_charger_current = <0xc3500>;
		ta_ac_charger_current = <0x2dc6c0>;
		jeita_temp_above_t4_cv_voltage = <0x40b280>;
		jeita_temp_t3_to_t4_cv_voltage = <0x40b280>;
		jeita_temp_t2_to_t3_cv_voltage = <0x423920>;
		jeita_temp_t1_to_t2_cv_voltage = <0x40b280>;
		jeita_temp_t0_to_t1_cv_voltage = <0x3da540>;
		jeita_temp_below_t0_cv_voltage = <0x3da540>;
		temp_t4_threshold = <0x32>;
		temp_t4_thres_minus_x_degree = <0x2d>;
		temp_t3_threshold = <0x2d>;
		temp_t3_thres_minus_x_degree = <0x27>;
		temp_t2_threshold = <0xa>;
		temp_t2_thres_plus_x_degree = <0x10>;
		temp_t1_threshold = <0x0>;
		temp_t1_thres_plus_x_degree = <0x2>;
		temp_t0_threshold = <0x0>;
		temp_t0_thres_plus_x_degree = <0x0>;
		temp_neg_10_threshold = <0x0>;
		enable_min_charge_temperature;
		min_charge_temperature = <0xfffffff1>;
		min_charge_temperature_plus_x_degree = <0x6>;
		max_charge_temperature = <0x37>;
		max_charge_temperature_minus_x_degree = <0x2f>;
		pe20_ichg_level_threshold = <0x3e8>;
		ta_start_battery_soc = <0x0>;
		ta_stop_battery_soc = <0x55>;
		chg1_ta_ac_charger_current = <0x16e360>;
		chg2_ta_ac_charger_current = <0x16e360>;
		cable_imp_threshold = <0x2bb>;
		vbat_cable_imp_threshold = <0xf3c>;
		bif_threshold1 = <0x40d990>;
		bif_threshold2 = <0x419ce0>;
		bif_cv_under_threshold2 = <0x43e6d0>;
		enable_sw_safety_timer;
		max_charging_time = <0xa8c0>;
		recharge_offset = <0x249f0>;
		topoff_voltage = <0x401640>;
		chg_full_current = <0x249f0>;
		linux,phandle = <0x5b>;
		phandle = <0x5b>;
	};

	pmic_clock_buffer_ctrl {
		compatible = "mediatek,pmic_clock_buffer";
		mediatek,clkbuf-quantity = <0x7>;
		mediatek,clkbuf-config = <0x2 0x1 0x1 0x2 0x0 0x0 0x0>;
		mediatek,clkbuf-driving-current = <0xffffffff 0xffffffff 0xffffffff 0xffffffff 0xffffffff 0xffffffff 0xffffffff>;
		linux,phandle = <0x5c>;
		phandle = <0x5c>;
	};

	consys@18070000 {
		compatible = "mediatek,mt6739-consys";
		#address-cells = <0x2>;
		#size-cells = <0x2>;
		reg = <0x0 0x18070000 0x0 0x200 0x0 0x10007000 0x0 0x100 0x0 0x10000000 0x0 0x2000 0x0 0x10006000 0x0 0x1000>;
		interrupts = <0x0 0xe9 0x8 0x0 0xeb 0x2>;
		clocks = <0x1a 0x3>;
		clock-names = "conn";
		linux,phandle = <0x5d>;
		phandle = <0x5d>;
	};

	gps {
		compatible = "mediatek,gps";
	};

	als_ps@0 {
		compatible = "mediatek,als_ps";
		linux,phandle = <0x5e>;
		phandle = <0x5e>;
	};

	gse_1 {
		linux,phandle = <0x5f>;
		phandle = <0x5f>;
	};

	mse {
		linux,phandle = <0x60>;
		phandle = <0x60>;
	};

	gyro {
		compatible = "mediatek,gyroscope";
		linux,phandle = <0x61>;
		phandle = <0x61>;
	};

	mrdump_ext_rst {
		compatible = "mediatek, mrdump_ext_rst-eint";
		source = "EINT";
		mode = "IRQ";
		status = "okay";
		linux,phandle = <0x62>;
		phandle = <0x62>;
	};

	msdc1_ins {
		linux,phandle = <0x63>;
		phandle = <0x63>;
	};

	chr_stat {
		linux,phandle = <0x64>;
		phandle = <0x64>;
	};

	rt9465_slave_chr {
		linux,phandle = <0x65>;
		phandle = <0x65>;
	};

	dsi_te {
		compatible = "mediatek, dsi_te-eint";
		status = "disabled";
		linux,phandle = <0x66>;
		phandle = <0x66>;
	};

	mtk6739_usb_otg_pin {
		compatible = "mediatek,mtk6739_usb_otg";
		linux,phandle = <0x67>;
		phandle = <0x67>;
	};

	kd_camera_hw1@15008000 {
		compatible = "mediatek,camera_hw";
		reg = <0x0 0x15008000 0x0 0x1000>;
		clocks = <0x25 0x2e 0x25 0x41 0x26 0x25 0x11 0x25 0x1a 0x25 0x10 0x25 0x1b 0x25 0x12 0x25 0x13 0x25 0x3f 0x25 0x37>;
		clock-names = "CLK_TOP_CAMTG_SEL", "CLK_TOP_CAMTG2_SEL", "CLK_TOP_CLK26M", "CLK_TOP_UNIVPLL_48M_D2", "CLK_TOP_UNIVPLL2_D8", "CLK_TOP_UNIVPLL_D26", "CLK_TOP_UNIVPLL2_D32", "CLK_TOP_UNIVPLL_48M_D4", "CLK_TOP_UNIVPLL_48M_D8", "CLK_TOP_SENINF_SEL", "CLK_TOP_SCAM_SEL";
		linux,phandle = <0x68>;
		phandle = <0x68>;
	};

	otg_iddig {
		compatible = "mediatek,usb_iddig_bi_eint";
		linux,phandle = <0x69>;
		phandle = <0x69>;
	};

	leds_rgb {
		compatible = "mediatek,mt6739-leds_rgb";
		linux,phandle = <0x6a>;
		phandle = <0x6a>;
	};

	nfc {
		compatible = "mediatek,nfc-gpio-v2";
		gpio-rst = <0x7>;
		gpio-rst-std = <0x24 0x7 0x0>;
		gpio-irq = <0xe>;
		gpio-irq-std = <0x24 0xe 0x0>;
		linux,phandle = <0x6b>;
		phandle = <0x6b>;
	};

	irq_nfc {
		compatible = "mediatek,irq_nfc-eint";
		linux,phandle = <0x6c>;
		phandle = <0x6c>;
	};

	md1_sim1_hot_plug_eint {
		linux,phandle = <0x6d>;
		phandle = <0x6d>;
	};

	md1_sim2_hot_plug_eint {
		linux,phandle = <0x6e>;
		phandle = <0x6e>;
	};

	irtx_pwm {
		compatible = "mediatek,irtx-pwm";
		pwm_ch = <0x1>;
		pwm_data_invert = <0x0>;
		linux,phandle = <0x6f>;
		phandle = <0x6f>;
	};

	firmware {

		android {
			compatible = "android,firmware";

			fstab {
				compatible = "android,fstab";

				system {
					compatible = "android,system";
					dev = "/dev/block/platform/bootdevice/by-name/system";
					type = "ext4";
					mnt_flags = "ro";
					fsmgr_flags = "wait,verify";
				};

				vendor {
					compatible = "android,vendor";
					dev = "/dev/block/platform/bootdevice/by-name/vendor";
					type = "ext4";
					mnt_flags = "ro";
					fsmgr_flags = "wait,verify";
				};
			};
		};
	};

	odm {
		compatible = "simple-bus";
		linux,phandle = <0x70>;
		phandle = <0x70>;
	};

	trusty {
		compatible = "android,trusty-smc-v1";
		ranges;
		#address-cells = <0x2>;
		#size-cells = <0x2>;

		irq {
			compatible = "android,trusty-irq-v1";
			ppi-interrupt-parent = <0x2>;
		};

		log {
			compatible = "android,trusty-log-v1";
		};

		virtio {
			compatible = "android,trusty-virtio-v1";
		};

		mtee {
			compatible = "mediatek,trusty-mtee-v1";
		};
	};

	mt_pmic_regulator {
		compatible = "mediatek,mt_pmic";

		buck_regulators {
			compatible = "mediatek,mt_pmic_buck_regulators";

			buck_vs1 {
				regulator-name = "vs1";
				regulator-min-microvolt = <0x124f80>;
				regulator-max-microvolt = <0x2191c0>;
				regulator-ramp-delay = <0x30d4>;
				regulator-enable-ramp-delay = <0xdc>;
				linux,phandle = <0x71>;
				phandle = <0x71>;
			};

			buck_vmodem {
				regulator-name = "vmodem";
				regulator-min-microvolt = <0x7a120>;
				regulator-max-microvolt = <0x123716>;
				regulator-ramp-delay = <0x186a>;
				regulator-enable-ramp-delay = <0xdc>;
				linux,phandle = <0x72>;
				phandle = <0x72>;
			};

			buck_vcore {
				regulator-name = "vcore";
				regulator-min-microvolt = <0x7ea5e>;
				regulator-max-microvolt = <0x1406f4>;
				regulator-ramp-delay = <0x186a>;
				regulator-enable-ramp-delay = <0xdc>;
				linux,phandle = <0x73>;
				phandle = <0x73>;
			};

			buck_vproc {
				regulator-name = "vproc";
				regulator-min-microvolt = <0x7ea5e>;
				regulator-max-microvolt = <0x1406f4>;
				regulator-ramp-delay = <0x186a>;
				regulator-enable-ramp-delay = <0xdc>;
				linux,phandle = <0x74>;
				phandle = <0x74>;
			};

			buck_vpa {
				regulator-name = "vpa";
				regulator-min-microvolt = <0x7a120>;
				regulator-max-microvolt = <0x37b1d0>;
				regulator-ramp-delay = <0xc350>;
				regulator-enable-ramp-delay = <0xdc>;
				linux,phandle = <0x75>;
				phandle = <0x75>;
			};
		};

		ldo_regulators {
			compatible = "mediatek,mt_pmic_ldo_regulators";

			ldo_vfe28 {
				compatible = "regulator-fixed";
				regulator-name = "vfe28";
				regulator-min-microvolt = <0x2ab980>;
				regulator-max-microvolt = <0x2ab980>;
				regulator-enable-ramp-delay = <0x108>;
				linux,phandle = <0x76>;
				phandle = <0x76>;
			};

			ldo_vxo22 {
				regulator-name = "vxo22";
				regulator-min-microvolt = <0x2191c0>;
				regulator-max-microvolt = <0x249f00>;
				regulator-enable-ramp-delay = <0x6e>;
				linux,phandle = <0x77>;
				phandle = <0x77>;
			};

			ldo_vrf18 {
				compatible = "regulator-fixed";
				regulator-name = "vrf18";
				regulator-min-microvolt = <0x1b7740>;
				regulator-max-microvolt = <0x1b7740>;
				regulator-enable-ramp-delay = <0x6e>;
				linux,phandle = <0x78>;
				phandle = <0x78>;
			};

			ldo_vrf12 {
				compatible = "regulator-fixed";
				regulator-name = "vrf12";
				regulator-min-microvolt = <0x124f80>;
				regulator-max-microvolt = <0x124f80>;
				regulator-enable-ramp-delay = <0x6e>;
				linux,phandle = <0x79>;
				phandle = <0x79>;
			};

			ldo_vefuse {
				regulator-name = "vefuse";
				regulator-min-microvolt = <0x124f80>;
				regulator-max-microvolt = <0x325aa0>;
				regulator-enable-ramp-delay = <0x108>;
				linux,phandle = <0x7a>;
				phandle = <0x7a>;
			};

			ldo_vcn33_bt {
				regulator-name = "vcn33_bt";
				regulator-min-microvolt = <0x325aa0>;
				regulator-max-microvolt = <0x3567e0>;
				regulator-enable-ramp-delay = <0x108>;
				linux,phandle = <0x7b>;
				phandle = <0x7b>;
			};

			ldo_vcn33_wifi {
				regulator-name = "vcn33_wifi";
				regulator-min-microvolt = <0x325aa0>;
				regulator-max-microvolt = <0x3567e0>;
				regulator-enable-ramp-delay = <0x108>;
				linux,phandle = <0x7c>;
				phandle = <0x7c>;
			};

			ldo_vcn28 {
				compatible = "regulator-fixed";
				regulator-name = "vcn28";
				regulator-min-microvolt = <0x2ab980>;
				regulator-max-microvolt = <0x2ab980>;
				regulator-enable-ramp-delay = <0x108>;
				linux,phandle = <0x7d>;
				phandle = <0x7d>;
			};

			ldo_vcn18 {
				compatible = "regulator-fixed";
				regulator-name = "vcn18";
				regulator-min-microvolt = <0x1b7740>;
				regulator-max-microvolt = <0x1b7740>;
				regulator-enable-ramp-delay = <0x108>;
				linux,phandle = <0x7e>;
				phandle = <0x7e>;
			};

			ldo_vcama {
				regulator-name = "vcama";
				regulator-min-microvolt = <0x2625a0>;
				regulator-max-microvolt = <0x2ab980>;
				regulator-enable-ramp-delay = <0x108>;
				linux,phandle = <0x7f>;
				phandle = <0x7f>;
			};

			ldo_vcamd {
				regulator-name = "vcamd";
				regulator-min-microvolt = <0xf4240>;
				regulator-max-microvolt = <0x1b7740>;
				regulator-enable-ramp-delay = <0x108>;
				linux,phandle = <0x80>;
				phandle = <0x80>;
			};

			ldo_vcamio {
				compatible = "regulator-fixed";
				regulator-name = "vcamio";
				regulator-min-microvolt = <0x1b7740>;
				regulator-max-microvolt = <0x1b7740>;
				regulator-enable-ramp-delay = <0x108>;
				linux,phandle = <0x81>;
				phandle = <0x81>;
			};

			ldo_vldo28 {
				regulator-name = "vldo28";
				regulator-min-microvolt = <0x2ab980>;
				regulator-max-microvolt = <0x2dc6c0>;
				regulator-enable-ramp-delay = <0x108>;
				linux,phandle = <0x82>;
				phandle = <0x82>;
			};

			ldo_vsram_others {
				regulator-name = "vsram_others";
				regulator-min-microvolt = <0x7ea5e>;
				regulator-max-microvolt = <0x1406f4>;
				regulator-ramp-delay = <0x186a>;
				regulator-enable-ramp-delay = <0x6e>;
				linux,phandle = <0x83>;
				phandle = <0x83>;
			};

			ldo_vsram_proc {
				regulator-name = "vsram_proc";
				regulator-min-microvolt = <0x7ea5e>;
				regulator-max-microvolt = <0x1406f4>;
				regulator-ramp-delay = <0x186a>;
				regulator-enable-ramp-delay = <0x6e>;
				linux,phandle = <0x84>;
				phandle = <0x84>;
			};

			ldo_vaux18 {
				compatible = "regulator-fixed";
				regulator-name = "vaux18";
				regulator-min-microvolt = <0x1b7740>;
				regulator-max-microvolt = <0x1b7740>;
				regulator-enable-ramp-delay = <0x108>;
				linux,phandle = <0x85>;
				phandle = <0x85>;
			};

			ldo_vaud28 {
				compatible = "regulator-fixed";
				regulator-name = "vaud28";
				regulator-min-microvolt = <0x2ab980>;
				regulator-max-microvolt = <0x2ab980>;
				regulator-enable-ramp-delay = <0x108>;
				linux,phandle = <0x86>;
				phandle = <0x86>;
			};

			ldo_vio28 {
				compatible = "regulator-fixed";
				regulator-name = "vio28";
				regulator-min-microvolt = <0x2ab980>;
				regulator-max-microvolt = <0x2ab980>;
				regulator-enable-ramp-delay = <0x108>;
				linux,phandle = <0x87>;
				phandle = <0x87>;
			};

			ldo_vio18 {
				compatible = "regulator-fixed";
				regulator-name = "vio18";
				regulator-min-microvolt = <0x1b7740>;
				regulator-max-microvolt = <0x1b7740>;
				regulator-enable-ramp-delay = <0x108>;
				linux,phandle = <0x88>;
				phandle = <0x88>;
			};

			ldo_vdram {
				regulator-name = "vdram";
				regulator-min-microvolt = <0x10c8e0>;
				regulator-max-microvolt = <0x124f80>;
				regulator-enable-ramp-delay = <0xce4>;
				linux,phandle = <0x89>;
				phandle = <0x89>;
			};

			ldo_vmc {
				regulator-name = "vmc";
				regulator-min-microvolt = <0x1b7740>;
				regulator-max-microvolt = <0x325aa0>;
				regulator-enable-ramp-delay = <0x2c>;
				linux,phandle = <0x30>;
				phandle = <0x30>;
			};

			ldo_vmch {
				regulator-name = "vmch";
				regulator-min-microvolt = <0x2c4020>;
				regulator-max-microvolt = <0x325aa0>;
				regulator-enable-ramp-delay = <0x2c>;
				linux,phandle = <0x2f>;
				phandle = <0x2f>;
			};

			ldo_vemc {
				regulator-name = "vemc";
				regulator-min-microvolt = <0x2c4020>;
				regulator-max-microvolt = <0x325aa0>;
				regulator-enable-ramp-delay = <0x2c>;
				linux,phandle = <0x29>;
				phandle = <0x29>;
			};

			ldo_vsim1 {
				regulator-name = "vsim1";
				regulator-min-microvolt = <0x19f0a0>;
				regulator-max-microvolt = <0x2f4d60>;
				regulator-enable-ramp-delay = <0x108>;
				linux,phandle = <0x8a>;
				phandle = <0x8a>;
			};

			ldo_vsim2 {
				regulator-name = "vsim2";
				regulator-min-microvolt = <0x19f0a0>;
				regulator-max-microvolt = <0x2f4d60>;
				regulator-enable-ramp-delay = <0x108>;
				linux,phandle = <0x8b>;
				phandle = <0x8b>;
			};

			ldo_vibr {
				regulator-name = "vibr";
				regulator-min-microvolt = <0x124f80>;
				regulator-max-microvolt = <0x325aa0>;
				regulator-enable-ramp-delay = <0x2c>;
				linux,phandle = <0x8c>;
				phandle = <0x8c>;
			};

			ldo_vusb33 {
				regulator-name = "vusb33";
				regulator-min-microvolt = <0x2dc6c0>;
				regulator-max-microvolt = <0x2f4d60>;
				regulator-enable-ramp-delay = <0x108>;
				linux,phandle = <0x8d>;
				phandle = <0x8d>;
			};
		};
	};

	__symbols__ {
		chosen = "/chosen";
		cpu0 = "/cpus/cpu@0";
		cpu1 = "/cpus/cpu@001";
		cpu2 = "/cpus/cpu@002";
		cpu3 = "/cpus/cpu@003";
		STANDBY = "/cpus/idle-states/standby";
		MCDI_CPU = "/cpus/idle-states/mcdi-cpu";
		MCDI_CLUSTER = "/cpus/idle-states/mcdi-cluster";
		SODI = "/cpus/idle-states/sodi";
		SODI3 = "/cpus/idle-states/sodi3";
		DPIDLE = "/cpus/idle-states/dpidle";
		SUSPEND = "/cpus/idle-states/suspend";
		cpu_dbgapb = "/cpu_dbgapb";
		reserved_memory = "/reserved-memory";
		gic = "/interrupt-controller@0c000000";
		sysirq = "/intpol-controller@0x10200620";
		clk26m = "/clk26m";
		topckgen = "/topckgen@10000000";
		infracfg_ao = "/infracfg_ao@10001000";
		scpsys = "/scpsys@10001000";
		clk32k = "/clk32k";
		syscfg_pctl_lt = "/syscfg_pctl_lt@10002000";
		syscfg_pctl_lm = "/syscfg_pctl_lm@10002200";
		syscfg_pctl_lb = "/syscfg_pctl_lb@10002400";
		syscfg_pctl_bl = "/syscfg_pctl_bl@10002600";
		syscfg_pctl_bm = "/syscfg_pctl_bm@10002800";
		syscfg_pctl_rb = "/syscfg_pctl_rb@10002a00";
		syscfg_pctl_rt = "/syscfg_pctl_bl@10002c00";
		gpio_usage_mapping = "/gpio";
		gpio = "/gpio@10005000";
		syscfg_pctl_a = "/syscfg_pctl_a@10005000";
		accdet = "/accdet";
		pio = "/pinctrl@1000b000";
		apmixed = "/apmixed@1000c000";
		main_pmic = "/pwrap@1000d000/pmic_irq";
		keypad = "/kp@10010000";
		mdcldma = "/mdcldma@10014000";
		auxadc = "/auxadc@11001000";
		apuart0 = "/apuart0@11002000";
		apuart1 = "/apuart1@11003000";
		i2c0 = "/i2c@11007000";
		i2c1 = "/i2c@11008000";
		i2c2 = "/i2c@11009000";
		i2c3 = "/i2c@1100f000";
		i2c4 = "/i2c@11011000";
		i2c5 = "/i2c@11016000";
		spi0 = "/spi@1100a000";
		spi1 = "/spi@11010000";
		spi2 = "/spi@11012000";
		msdc0 = "/msdc@11230000";
		msdc0_pins_default = "/msdc@11230000/msdc0@default";
		msdc0_register_setting_default = "/msdc@11230000/msdc0@register_default";
		msdc1 = "/msdc@11240000";
		msdc1_pins_default = "/msdc@11240000/msdc1@default";
		msdc1_pins_sdr104 = "/msdc@11240000/msdc1@sdr104";
		msdc1_pins_sdr50 = "/msdc@11240000/msdc1@sdr50";
		msdc1_pins_ddr50 = "/msdc@11240000/msdc1@ddr50";
		msdc1_register_setting_default = "/msdc@11240000/msdc1@register_default";
		audio = "/audio@11220000";
		audgpio = "/mt_soc_dl1_pcm@11220000";
		mmsys_config = "/mmsys_config@14000000";
		touch = "/touch";
		dummy_camera = "/dummy_camera@";
		flashlight_core = "/flashlight_core";
		flashlights_rt4505 = "/flashlights_rt4505";
		flashlight_main = "/flashlight_main";
		flashlight_sub = "/flashlight_sub";
		mtkfb = "/mtkfb";
		disp_mutex = "/disp_mutex@14001000";
		smi_larb0 = "/smi_larb0@14003000";
		mdp_rdma0 = "/mdp_rdma0@14004000";
		mdp_rsz0 = "/mdp_rsz0@14005000";
		mdp_rsz1 = "/mdp_rsz1@14006000";
		mdp_wdma0 = "/mdp_wdma0@14007000";
		mdp_wrot0 = "/mdp_wrot0@14008000";
		mdp_tdshp0 = "/mdp_tdshp0@14009000";
		disp_ovl0 = "/disp_ovl0@1400a000";
		disp_aal0 = "/disp_aal0@1400f000";
		dispsys = "/dispsys@14000000";
		mm_mutex = "/mm_mutex@14016000";
		imgsys_config = "/imgsys_config@15000000";
		smi_larb2 = "/smi_larb2@15001000";
		venc_global_con = "/venc_global_con@17000000";
		venc = "/venc@17020000";
		smi_larb1 = "/smi_larb1@17010000";
		bat_gm30 = "/bat_gm30";
		mt_charger = "/mt_charger";
		charger = "/charger";
		pmic_clock_buffer_ctrl = "/pmic_clock_buffer_ctrl";
		consys = "/consys@18070000";
		als = "/als_ps@0";
		gse_1 = "/gse_1";
		mse = "/mse";
		gyro = "/gyro";
		mrdump_ext_rst = "/mrdump_ext_rst";
		msdc1_ins = "/msdc1_ins";
		chr_stat = "/chr_stat";
		rt9465_slave_chr = "/rt9465_slave_chr";
		dsi_te = "/dsi_te";
		usb_otg = "/mtk6739_usb_otg_pin";
		kd_camera_hw1 = "/kd_camera_hw1@15008000";
		otg_iddig = "/otg_iddig";
		leds_rgb = "/leds_rgb";
		nfc = "/nfc";
		irq_nfc = "/irq_nfc";
		md1_sim1_hot_plug_eint = "/md1_sim1_hot_plug_eint";
		md1_sim2_hot_plug_eint = "/md1_sim2_hot_plug_eint";
		irtx_pwm = "/irtx_pwm";
		odm = "/odm";
		mt_pmic_vs1_buck_reg = "/mt_pmic_regulator/buck_regulators/buck_vs1";
		mt_pmic_vmodem_buck_reg = "/mt_pmic_regulator/buck_regulators/buck_vmodem";
		mt_pmic_vcore_buck_reg = "/mt_pmic_regulator/buck_regulators/buck_vcore";
		mt_pmic_vproc_buck_reg = "/mt_pmic_regulator/buck_regulators/buck_vproc";
		mt_pmic_vpa_buck_reg = "/mt_pmic_regulator/buck_regulators/buck_vpa";
		mt_pmic_vfe28_ldo_reg = "/mt_pmic_regulator/ldo_regulators/ldo_vfe28";
		mt_pmic_vxo22_ldo_reg = "/mt_pmic_regulator/ldo_regulators/ldo_vxo22";
		mt_pmic_vrf18_ldo_reg = "/mt_pmic_regulator/ldo_regulators/ldo_vrf18";
		mt_pmic_vrf12_ldo_reg = "/mt_pmic_regulator/ldo_regulators/ldo_vrf12";
		mt_pmic_vefuse_ldo_reg = "/mt_pmic_regulator/ldo_regulators/ldo_vefuse";
		mt_pmic_vcn33_bt_ldo_reg = "/mt_pmic_regulator/ldo_regulators/ldo_vcn33_bt";
		mt_pmic_vcn33_wifi_ldo_reg = "/mt_pmic_regulator/ldo_regulators/ldo_vcn33_wifi";
		mt_pmic_vcn28_ldo_reg = "/mt_pmic_regulator/ldo_regulators/ldo_vcn28";
		mt_pmic_vcn18_ldo_reg = "/mt_pmic_regulator/ldo_regulators/ldo_vcn18";
		mt_pmic_vcama_ldo_reg = "/mt_pmic_regulator/ldo_regulators/ldo_vcama";
		mt_pmic_vcamd_ldo_reg = "/mt_pmic_regulator/ldo_regulators/ldo_vcamd";
		mt_pmic_vcamio_ldo_reg = "/mt_pmic_regulator/ldo_regulators/ldo_vcamio";
		mt_pmic_vldo28_ldo_reg = "/mt_pmic_regulator/ldo_regulators/ldo_vldo28";
		mt_pmic_vsram_others_ldo_reg = "/mt_pmic_regulator/ldo_regulators/ldo_vsram_others";
		mt_pmic_vsram_proc_ldo_reg = "/mt_pmic_regulator/ldo_regulators/ldo_vsram_proc";
		mt_pmic_vaux18_ldo_reg = "/mt_pmic_regulator/ldo_regulators/ldo_vaux18";
		mt_pmic_vaud28_ldo_reg = "/mt_pmic_regulator/ldo_regulators/ldo_vaud28";
		mt_pmic_vio28_ldo_reg = "/mt_pmic_regulator/ldo_regulators/ldo_vio28";
		mt_pmic_vio18_ldo_reg = "/mt_pmic_regulator/ldo_regulators/ldo_vio18";
		mt_pmic_vdram_ldo_reg = "/mt_pmic_regulator/ldo_regulators/ldo_vdram";
		mt_pmic_vmc_ldo_reg = "/mt_pmic_regulator/ldo_regulators/ldo_vmc";
		mt_pmic_vmch_ldo_reg = "/mt_pmic_regulator/ldo_regulators/ldo_vmch";
		mt_pmic_vemc_ldo_reg = "/mt_pmic_regulator/ldo_regulators/ldo_vemc";
		mt_pmic_vsim1_ldo_reg = "/mt_pmic_regulator/ldo_regulators/ldo_vsim1";
		mt_pmic_vsim2_ldo_reg = "/mt_pmic_regulator/ldo_regulators/ldo_vsim2";
		mt_pmic_vibr_ldo_reg = "/mt_pmic_regulator/ldo_regulators/ldo_vibr";
		mt_pmic_vusb33_ldo_reg = "/mt_pmic_regulator/ldo_regulators/ldo_vusb33";
	};
};
